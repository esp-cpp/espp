## components/switch2_pro/Kconfig
```kconfig
menu "Switch 2 Pro Controller"

    config SWITCH2_PRO_PATCH_NIMBLE_5MS
        bool "Patch the BLE controller to allow the console's 5 ms connection interval"
        default n
        help
            The console drives the link at a 5 ms connection interval, below the
            7.5 ms Bluetooth spec minimum. It reaches 5 ms in every mode: on
            RECONNECT and WAKE-FROM-SLEEP it connects a recognised (bonded)
            controller at 5 ms from its CONNECT_IND, and on a FRESH session it
            renegotiates down to 5 ms (LL_CONNECTION_UPDATE) about 1.5 s after the
            console subscribes to input. The controller stack must accept that
            sub-spec interval or the connection/stream fails.

            THIS OPTION IS ONLY FOR THE OPEN NimBLE CONTROLLER CHIPS
            (ESP32-C6/C61/C2/H2), which have no config option for a sub-spec
            interval. On ESP32-S3 / C3 use the OFFICIAL ESP-IDF option instead:
            CONFIG_BT_CTRL_BLE_MIN_CONN_INTERVAL_ENABLE (default y) lets the BTDM
            controller and the BLE host accept sub-spec intervals with no binary
            patching, in ESP-IDF >= v6.1 (or the v6.0/v5.5/v5.4/v5.3 backports; see
            espressif/esp-idf#18467). Enabling THIS option on S3/C3 is a build
            error — there is no verified S3/C3 binary-patch fallback.

            When enabled on a supported chip, the component build patches the
            prebuilt closed controller library in your global $IDF_PATH install to
            lower the minimum-interval floor from 6 units (7.5 ms) to 4 (5 ms):
            ESP32-C6/C61/C2/H2 NimBLE controller (libble_app.a).
            THIS MODIFIES YOUR ESP-IDF INSTALLATION. Undo with
            tools/patch_nimble_5ms.py --target <chip> --restore, and verify with
            tools/smoke_test_5ms.py --target <chip>.

            Required for SUSTAINED input (fresh or reconnected) as well as
            reconnect and wake-from-sleep. Only the initial pairing handshake
            (~15 ms, the first ~1.5 s) works without sub-spec support. Leave OFF
            only if you accept that the console will drop the session once it
            switches to 5 ms.

endmenu
```

## components/sx126x/example/main/Kconfig.projbuild
```kconfig
menu "Example Configuration"

choice EXAMPLE_HARDWARE
  prompt "Hardware"
  default EXAMPLE_HARDWARE_TDECK
  help
    Select the hardware to run this example on.

config EXAMPLE_HARDWARE_TDECK
  depends on IDF_TARGET_ESP32S3
  bool "LilyGo T-Deck / T-Deck Plus (SX1262)"

config EXAMPLE_HARDWARE_CARDPUTER_ADV
  depends on IDF_TARGET_ESP32S3
  bool "M5Stack Cardputer-Adv + LoRa+GPS Cap (SX1262)"

config EXAMPLE_HARDWARE_CUSTOM
  bool "Custom"
endchoice

config EXAMPLE_RADIO_FREQUENCY_HZ
  int "Radio frequency (Hz)"
  range 150000000 960000000
  default 906875000
  help
    RF center frequency in Hz. Make sure this matches your hardware variant
    and is legal in your region! Default is the Meshtastic US LongFast
    frequency slot (906.875 MHz). EU868 users should use 869525000.

config EXAMPLE_SPI_SCLK_GPIO
  int "SPI SCLK GPIO Num"
  range 0 50
  default 40 if EXAMPLE_HARDWARE_TDECK
  default 40 if EXAMPLE_HARDWARE_CARDPUTER_ADV
  default 12 if EXAMPLE_HARDWARE_CUSTOM

config EXAMPLE_SPI_MOSI_GPIO
  int "SPI MOSI GPIO Num"
  range 0 50
  default 41 if EXAMPLE_HARDWARE_TDECK
  default 14 if EXAMPLE_HARDWARE_CARDPUTER_ADV
  default 11 if EXAMPLE_HARDWARE_CUSTOM

config EXAMPLE_SPI_MISO_GPIO
  int "SPI MISO GPIO Num"
  range 0 50
  default 38 if EXAMPLE_HARDWARE_TDECK
  default 39 if EXAMPLE_HARDWARE_CARDPUTER_ADV
  default 13 if EXAMPLE_HARDWARE_CUSTOM

config EXAMPLE_RADIO_CS_GPIO
  int "Radio chip select (NSS) GPIO Num"
  range 0 50
  default 9 if EXAMPLE_HARDWARE_TDECK
  default 5 if EXAMPLE_HARDWARE_CARDPUTER_ADV
  default 10 if EXAMPLE_HARDWARE_CUSTOM

config EXAMPLE_RADIO_DIO1_GPIO
  int "Radio DIO1 (IRQ) GPIO Num"
  range 0 50
  default 45 if EXAMPLE_HARDWARE_TDECK
  default 4 if EXAMPLE_HARDWARE_CARDPUTER_ADV
  default 14 if EXAMPLE_HARDWARE_CUSTOM

config EXAMPLE_RADIO_BUSY_GPIO
  int "Radio BUSY GPIO Num"
  range 0 50
  default 13 if EXAMPLE_HARDWARE_TDECK
  default 6 if EXAMPLE_HARDWARE_CARDPUTER_ADV
  default 15 if EXAMPLE_HARDWARE_CUSTOM

config EXAMPLE_RADIO_RESET_GPIO
  int "Radio NRESET GPIO Num"
  range 0 50
  default 17 if EXAMPLE_HARDWARE_TDECK
  default 3 if EXAMPLE_HARDWARE_CARDPUTER_ADV
  default 16 if EXAMPLE_HARDWARE_CUSTOM

config EXAMPLE_POWER_ENABLE_GPIO
  int "Board power-enable GPIO Num (-1 if none)"
  range -1 50
  default 10 if EXAMPLE_HARDWARE_TDECK
  default -1 if EXAMPLE_HARDWARE_CARDPUTER_ADV
  default -1 if EXAMPLE_HARDWARE_CUSTOM
  help
    GPIO which must be driven high to power the radio (e.g. the T-Deck
    peripheral power rail on GPIO 10). Set to -1 if not needed.

config EXAMPLE_RADIO_HAS_TCXO
  bool "Radio module has a TCXO on DIO3"
  default y if EXAMPLE_HARDWARE_TDECK
  default n
  help
    Whether the radio module uses DIO3 to power a TCXO (true for the
    T-Deck's HPD16A module, at 1.8V).

config EXAMPLE_TRANSMIT_INTERVAL_MS
  int "Transmit interval (ms)"
  range 1000 3600000
  default 5000
  help
    How often to transmit a ping packet.

endmenu
```

## components/usb_device/msc_example/main/Kconfig.projbuild
```kconfig
menu "MSC Example Configuration"

    choice MSC_EXAMPLE_MEDIUM
        prompt "Medium exposed as the USB drive"
        default MSC_EXAMPLE_MEDIUM_FLASH
        help
            What the mass-storage interface hands to the host.

        config MSC_EXAMPLE_MEDIUM_FLASH
            bool "FAT partition in flash ('storage' in partitions.csv)"
        config MSC_EXAMPLE_MEDIUM_SDCARD
            bool "SD card via espp::SdCard (SDMMC, pins below)"
            help
                Probes the card with espp::SdCard (no mount) and hands the raw card
                to the MSC function. The pin defaults are the LilyGo T-Dongle-S3's
                microSD slot.
        config MSC_EXAMPLE_MEDIUM_BSP_T_DONGLE_S3
            bool "SD card of the LilyGo T-Dongle-S3 (BSP)"
            help
                Uses the espp::TDongleS3 board support: initialize_sdcard() mounts
                the card, the example unmounts it through sdcard_component() and
                hands sdcard() to the MSC function. This is the pattern for any
                espp BSP with a microSD slot.
    endchoice

    if MSC_EXAMPLE_MEDIUM_SDCARD
        choice MSC_EXAMPLE_SDMMC_BUS_WIDTH
            prompt "Bus width"
            default MSC_EXAMPLE_SDMMC_BUS_WIDTH_4
            config MSC_EXAMPLE_SDMMC_BUS_WIDTH_4
                bool "4-bit (CLK, CMD, D0-D3)"
            config MSC_EXAMPLE_SDMMC_BUS_WIDTH_1
                bool "1-bit (CLK, CMD, D0)"
        endchoice
        config MSC_EXAMPLE_SDMMC_CLK
            int "CLK GPIO"
            default 12
        config MSC_EXAMPLE_SDMMC_CMD
            int "CMD GPIO"
            default 16
        config MSC_EXAMPLE_SDMMC_D0
            int "D0 GPIO"
            default 14
        config MSC_EXAMPLE_SDMMC_D1
            int "D1 GPIO"
            default 17
            depends on MSC_EXAMPLE_SDMMC_BUS_WIDTH_4
        config MSC_EXAMPLE_SDMMC_D2
            int "D2 GPIO"
            default 21
            depends on MSC_EXAMPLE_SDMMC_BUS_WIDTH_4
        config MSC_EXAMPLE_SDMMC_D3
            int "D3 GPIO"
            default 18
            depends on MSC_EXAMPLE_SDMMC_BUS_WIDTH_4
        config MSC_EXAMPLE_SDMMC_LDO_CHANNEL
            int "On-chip LDO channel powering the card (-1 = none)"
            default 4 if IDF_TARGET_ESP32P4
            default -1
            help
                The ESP32-P4 powers its SD pads from LDO channel 4. Leave -1 on
                other targets.
    endif

endmenu
```

## components/usb_device/xinput_example/main/Kconfig.projbuild
```kconfig
menu "X-Input Example Configuration"

    config XINPUT_EXAMPLE_COMPOSITE
        bool "Composite: add a WebUSB vendor interface beside the X-Input one"
        default n
        help
            Off: X-Input is the only function, the device carries the Xbox 360
            controller's own identity (0x045E:0x028E, a 0xFF device class) and a
            PC binds it as that controller.

            On: a WebUSB vendor interface is added (as a configuration console
            would be), so the device is a composite one (0x00 device class). It
            then advertises the "XUSB10" compatible ID for the X-Input interface
            through the Microsoft OS 2.0 descriptor, which Windows' Xbox 360
            driver matches, and Linux's xpad matches the interface class under
            the Microsoft vendor ID. Needs the built-in vendor class driver:
            build with `-DSDKCONFIG_DEFAULTS="sdkconfig.defaults;sdkconfig.composite"`.

    config XINPUT_EXAMPLE_COMPOSITE_PID
        hex "Composite product ID (under vendor ID 0x045E)"
        depends on XINPUT_EXAMPLE_COMPOSITE
        default 0x0E60
        help
            Windows binds its Xbox 360 driver to the WHOLE device when the
            device's VID:PID is one its driver INF lists by hardware ID (the
            retail controllers: 0x028E, 0x0719, ...), which would hide the vendor
            interface. A composite device therefore needs a product ID that INF
            does not list; the vendor ID stays Microsoft's so Linux's xpad
            recognizes the interface. Emulation / testing of your own device only.

endmenu
```

## components/usb_host/tab5_example/main/Kconfig.projbuild
```kconfig
menu "USB Host Tab5 Example Configuration"

    config USB_HOST_TAB5_ROOT_PORT_POWER_ON_DELAY_MS
        int "Delay between host install and root-port power-on (ms)"
        range 0 5000
        default 500
        help
            A device attached at power-up is enumerated as soon as the root port
            powers on; this margin lets the board's supply settle after a cold
            boot before that first enumeration. 0 powers the port at once.

    config USB_HOST_TAB5_CONTROL_USB_A_POWER
        bool "Switch the USB-A jack's 5 V from the example"
        default y
        help
            The Tab5 switches the jack's 5 V through an IO expander, not the USB
            controller, so the host library's own root-port power-off does not
            reach a device on the jack. With this on, the jack is off from
            start-up until the host is listening, so a device attached at boot
            sees VBUS and a listening host together.

endmenu
```

## components/vl53l/vl53l5cx_example/main/Kconfig.projbuild
```kconfig
menu "Example Configuration"

    choice EXAMPLE_HARDWARE
        prompt "Hardware"
        default EXAMPLE_HARDWARE_QTPY if IDF_TARGET_ESP32 || IDF_TARGET_ESP32S3
        default EXAMPLE_HARDWARE_ESP32_P4_DEVKIT if IDF_TARGET_ESP32P4
        default EXAMPLE_HARDWARE_CUSTOM
        help
            Select the hardware to run this example on.

        config EXAMPLE_HARDWARE_QTPY
            bool "QtPy ESP32 Pico or QtPy ESP32-S3"
            depends on IDF_TARGET_ESP32 || IDF_TARGET_ESP32S3

        config EXAMPLE_HARDWARE_ESP32_P4_DEVKIT
            bool "ESP32-P4 dev kit (ESP32-P4-Function-EV / WIFI6 dev kit: SDA 7, SCL 8)"
            depends on IDF_TARGET_ESP32P4

        config EXAMPLE_HARDWARE_CUSTOM
            bool "Custom"
    endchoice

    config EXAMPLE_I2C_SCL_GPIO
        int "SCL GPIO Num"
        range 0 54
        default 40 if EXAMPLE_HARDWARE_QTPY && IDF_TARGET_ESP32S3
        default 19 if EXAMPLE_HARDWARE_QTPY && IDF_TARGET_ESP32
        default 8 if EXAMPLE_HARDWARE_ESP32_P4_DEVKIT
        default 8 if IDF_TARGET_ESP32P4
        default 19
        help
            GPIO number for I2C Master clock line.

    config EXAMPLE_I2C_SDA_GPIO
        int "SDA GPIO Num"
        range 0 54
        default 41 if EXAMPLE_HARDWARE_QTPY && IDF_TARGET_ESP32S3
        default 22 if EXAMPLE_HARDWARE_QTPY && IDF_TARGET_ESP32
        default 7 if EXAMPLE_HARDWARE_ESP32_P4_DEVKIT
        default 7 if IDF_TARGET_ESP32P4
        default 22
        help
            GPIO number for I2C Master data line.

    config EXAMPLE_I2C_CLOCK_SPEED_HZ
        int "I2C Clock Speed"
        range 100 1000000
        default 400000
        help
            I2C clock speed in Hz. The VL53L5CX supports up to 1 MHz (Fast Mode
            Plus); the firmware upload at initialization takes about two
            seconds at 400 kHz.

    choice EXAMPLE_VARIANT
        prompt "Sensor part"
        default EXAMPLE_VARIANT_VL53L5CX
        help
            The VL53L5CX (63 deg field of view) and the VL53L7CX (90 deg) answer
            the same ids over I2C but need different firmware images; pick the
            part printed on the module.

        config EXAMPLE_VARIANT_VL53L5CX
            bool "VL53L5CX"

        config EXAMPLE_VARIANT_VL53L7CX
            bool "VL53L7CX"
    endchoice

    choice EXAMPLE_RESOLUTION
        prompt "Ranging resolution"
        default EXAMPLE_RESOLUTION_8X8
        help
            Number of ranging zones.

        config EXAMPLE_RESOLUTION_4X4
            bool "4x4 zones (up to 60 Hz)"

        config EXAMPLE_RESOLUTION_8X8
            bool "8x8 zones (up to 15 Hz)"
    endchoice

    config EXAMPLE_RANGING_FREQUENCY_HZ
        int "Ranging frequency (Hz)"
        range 1 60
        default 15
        help
            Frames per second: 1..60 Hz in 4x4, 1..15 Hz in 8x8.

    config EXAMPLE_MOTION_INDICATOR
        bool "Enable the motion indicator"
        default n
        help
            Have the sensor report, per aggregate of zones, how much the scene
            moved between frames, and print it with every frame.

    config EXAMPLE_MOTION_MIN_MM
        int "Motion window start (mm)"
        depends on EXAMPLE_MOTION_INDICATOR
        range 400 4000
        default 400

    config EXAMPLE_MOTION_MAX_MM
        int "Motion window end (mm)"
        depends on EXAMPLE_MOTION_INDICATOR
        range 400 4000
        default 1500
        help
            At most 1500 mm past the window start.

endmenu
```
