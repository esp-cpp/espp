## components/vl53l/vl53l5cx_webapp_example/main/Kconfig.projbuild
```kconfig
menu "Example Configuration"

    choice EXAMPLE_HARDWARE
        prompt "Hardware"
        default EXAMPLE_HARDWARE_QTPY if IDF_TARGET_ESP32S3
        default EXAMPLE_HARDWARE_ESP32_P4_DEVKIT if IDF_TARGET_ESP32P4
        default EXAMPLE_HARDWARE_CUSTOM
        help
            Select the hardware to run this example on. The USB vendor
            (WebUSB) + CDC (Web Serial) transports need the native USB-OTG
            peripheral: ESP32-S2 / S3 / P4.

        config EXAMPLE_HARDWARE_QTPY
            bool "QtPy ESP32-S3 (SDA 41, SCL 40)"
            depends on IDF_TARGET_ESP32S3

        config EXAMPLE_HARDWARE_ESP32_P4_DEVKIT
            bool "ESP32-P4 dev kit (ESP32-P4-Function-EV / WIFI6 dev kit: SDA 7, SCL 8)"
            depends on IDF_TARGET_ESP32P4

        config EXAMPLE_HARDWARE_CUSTOM
            bool "Custom"
    endchoice

    config EXAMPLE_I2C_SCL_GPIO
        int "SCL GPIO Num"
        range 0 54
        default 40 if EXAMPLE_HARDWARE_QTPY
        default 8 if EXAMPLE_HARDWARE_ESP32_P4_DEVKIT
        default 8 if IDF_TARGET_ESP32P4
        default 40
        help
            GPIO number for I2C Master clock line.

    config EXAMPLE_I2C_SDA_GPIO
        int "SDA GPIO Num"
        range 0 54
        default 41 if EXAMPLE_HARDWARE_QTPY
        default 7 if EXAMPLE_HARDWARE_ESP32_P4_DEVKIT
        default 7 if IDF_TARGET_ESP32P4
        default 41
        help
            GPIO number for I2C Master data line.

    config EXAMPLE_I2C_CLOCK_SPEED_HZ
        int "I2C Clock Speed"
        range 100 1000000
        default 400000
        help
            I2C clock speed in Hz. The VL53L5CX supports up to 1 MHz (Fast Mode
            Plus); the firmware upload at initialization takes about two
            seconds at 400 kHz.

    choice EXAMPLE_VARIANT
        prompt "Sensor part"
        default EXAMPLE_VARIANT_VL53L5CX
        help
            The VL53L5CX (63 deg field of view) and the VL53L7CX (90 deg) answer
            the same ids over I2C but need different firmware images; pick the
            part printed on the module.

        config EXAMPLE_VARIANT_VL53L5CX
            bool "VL53L5CX"

        config EXAMPLE_VARIANT_VL53L7CX
            bool "VL53L7CX"
    endchoice

    choice EXAMPLE_RESOLUTION
        prompt "Ranging resolution at boot"
        default EXAMPLE_RESOLUTION_8X8
        help
            Number of ranging zones at boot (the web app can change it).

        config EXAMPLE_RESOLUTION_4X4
            bool "4x4 zones (up to 60 Hz)"

        config EXAMPLE_RESOLUTION_8X8
            bool "8x8 zones (up to 15 Hz)"
    endchoice

    config EXAMPLE_RANGING_FREQUENCY_HZ
        int "Ranging frequency at boot (Hz)"
        range 1 60
        default 15
        help
            Frames per second at boot: 1..60 Hz in 4x4, 1..15 Hz in 8x8 (the
            web app can change it).

    config EXAMPLE_START_RANGING_AT_BOOT
        bool "Start ranging at boot"
        default y
        help
            Start ranging as soon as the sensor is initialized, so frames are
            available the moment a host connects. Otherwise ranging starts
            from the web app (START).

    choice EXAMPLE_USB_PORT
        prompt "USB port"
        default EXAMPLE_USB_PORT_DEFAULT
        help
            Which USB-OTG port TinyUSB drives. The ESP32-P4 has two: the
            USB 2.0 high-speed port (TinyUSB's default there) and the USB 1.1
            full-speed port shared with the USB-Serial-JTAG console. Boards do
            not always route the high-speed port to a device-capable
            connector, so pick the one wired to the connector you plug the
            host into. Other targets have a single full-speed port.

        config EXAMPLE_USB_PORT_DEFAULT
            bool "TinyUSB's default for the target (P4: high-speed)"

        config EXAMPLE_USB_PORT_FULL_SPEED
            bool "USB 1.1 full-speed port (shared with USB-Serial-JTAG)"

        config EXAMPLE_USB_PORT_HIGH_SPEED
            bool "USB 2.0 high-speed port (ESP32-P4)"
            depends on IDF_TARGET_ESP32P4
    endchoice

endmenu
```

## components/wdi/ble_central_example/sdkconfig.defaults
```kconfig
CONFIG_ESP_SYSTEM_EVENT_TASK_STACK_SIZE=4096
CONFIG_ESP_MAIN_TASK_STACK_SIZE=8192
CONFIG_FREERTOS_HZ=1000
CONFIG_ESPTOOLPY_FLASHSIZE_4MB=y
CONFIG_PARTITION_TABLE_CUSTOM=y
CONFIG_PARTITION_TABLE_CUSTOM_FILENAME="partitions.csv"
CONFIG_BT_ENABLED=y
CONFIG_BT_BLUEDROID_ENABLED=n
CONFIG_BT_NIMBLE_ENABLED=y
CONFIG_BT_NIMBLE_LOG_LEVEL_NONE=y
CONFIG_BT_NIMBLE_NVS_PERSIST=y
CONFIG_BT_NIMBLE_HOST_TASK_STACK_SIZE=8192
CONFIG_NIMBLE_CPP_LOG_LEVEL_NONE=y
```
