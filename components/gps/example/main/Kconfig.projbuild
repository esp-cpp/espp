## components/rtps/example/main/Kconfig.projbuild
```kconfig
menu "RTPS Example Configuration"

    config RTPS_EXAMPLE_ANNOUNCE_PERIOD_MS
        int "Publish period (ms)"
        range 200 60000
        default 1500
        help
            Period between outgoing messages published by the MCU.

    config RTPS_EXAMPLE_SECOND_PARTICIPANT
        bool "Add a second (self-test) participant that calls the local servers"
        default n
        depends on RTPS_ENABLE_RPC
        help
            Additively bring up a SECOND RtpsParticipant on the device, with its
            own typed ServiceClient + ActionClient, that call THIS device's own
            /add_two_ints service and /fibonacci action. A participant filters out
            its own messages, so this is the only way to fully round-trip the
            client APIs on one device with no external peer - a self-contained
            self-test. Off by default: a second participant roughly doubles the
            RTPS engine's RAM (two discovery stacks, socket sets, and pools), which
            may not fit on a plain ESP32 without PSRAM. Independent of the
            peer-facing client demo, which always runs.

endmenu
```

## components/rtps/interop/qemu/main/Kconfig.projbuild
```kconfig
menu "RTPS QEMU interop firmware"

    config RTPS_QEMU_STATIC_IP
        bool "Use a static IPv4 address instead of DHCP"
        default n
        help
            The harness runs QEMU on a tap device with no DHCP server, so CI
            builds set this (sdkconfig.ci.defaults). A developer running
            `idf.py qemu` on the user-mode NAT leaves it off and gets an
            address from QEMU.

    config RTPS_QEMU_IP
        string "IPv4 address"
        depends on RTPS_QEMU_STATIC_IP
        default "192.168.100.2"

    config RTPS_QEMU_NETMASK
        string "IPv4 netmask"
        depends on RTPS_QEMU_STATIC_IP
        default "255.255.255.0"

    config RTPS_QEMU_GATEWAY
        string "IPv4 gateway"
        depends on RTPS_QEMU_STATIC_IP
        default "192.168.100.1"

endmenu
```

## components/rtps_embedded/Kconfig
```kconfig
menu "RTPS (rtps_embedded)"

    choice RTPS_LIMITS_PROFILE
        prompt "RTPS static limits profile"
        default RTPS_LIMITS_PROFILE_EMBEDDED
        help
            Selects the compile-time capacity limits (profile header) used by the
            rtps_embedded engine. Only the capacity caps differ between profiles.
            The storage MODEL (static vs dynamic) is a separate knob
            (RTPS_STORAGE_DYNAMIC below) and defaults to fully-static on ESP for
            every profile - selecting a relaxed profile does NOT enable heap
            storage. These caps are pure capacity limits and do NOT change any
            bytes on the wire.

        config RTPS_LIMITS_PROFILE_EMBEDDED
            bool "embedded (tight MCU caps)"
            help
                Tight caps sized for an ESP32-class MCU
                (rtps/config_esp32.hpp). This is the default and the smallest
                footprint.

        config RTPS_LIMITS_PROFILE_HOST
            bool "host (relaxed static caps)"
            help
                Relaxed static caps suitable for small-to-medium DDS graphs
                (rtps/config_desktop.hpp). Larger footprint than embedded.

        config RTPS_LIMITS_PROFILE_HOST_LARGE
            bool "host_large (generous static caps)"
            help
                Generous static caps for large DDS graphs
                (rtps/config_host_large.hpp). Significantly larger footprint;
                only appropriate on targets with plenty of RAM.
    endchoice

    config RTPS_STORAGE_DYNAMIC
        bool "Use dynamic (heap) history/queue storage"
        default n
        help
            By default the engine uses fully-static, zero-heap history and queue
            storage on ESP targets (std::array), independent of the limits
            profile above: when a history fills it drops the oldest sample.
            Enable this to use heap-backed storage (std::deque) that instead
            GROWS on demand to retain samples. Off by default so the MCU keeps
            deterministic, zero-heap storage; enable only on targets that can
            afford heap growth. Does not change any bytes on the wire.

    config RTPS_ENABLE_FRAGMENTATION
        bool "Enable best-effort DATA_FRAG fragmentation"
        default n
        help
            Enables sending and receiving samples larger than a single RTPS DATA
            submessage (> ~64 KB) by splitting them into best-effort DATA_FRAG
            submessages and reassembling them on receive (interoperates with
            FastDDS / ROS 2). Default OFF so the MCU pays no code or memory cost
            for it in the common (small-sample) case. When ON, reassembly is
            bounded by RTPS_MAX_SAMPLE_SIZE (256 KB on the embedded profile) and
            the participant's max payload size rises accordingly.

    config RTPS_ENABLE_RPC
        bool "Enable RPC: services + actions (RMI/AMI)"
        default y
        help
            Compiles in the request/reply (services) and goal (actions) layers of
            the RtpsParticipant facade - both the ROS 2-interoperable
            (add_service_*/add_action_*) and native (add_native_*) variants.
            Disable to drop all of that code (and its std::thread/std::future use)
            when the device only needs pub/sub, saving flash. Pure pub/sub is
            unaffected either way. Default ON.

endmenu
```

## components/rtps_embedded/example/main/Kconfig.projbuild
```kconfig
menu "RTPS Example Configuration"

    config RTPS_EXAMPLE_ANNOUNCE_PERIOD_MS
        int "Publish period (ms)"
        range 200 60000
        default 1500
        help
            Period between outgoing messages published by the MCU.

endmenu
```

## components/rtps_embedded/example/sdkconfig.defaults
```kconfig
CONFIG_COMPILER_OPTIMIZATION_PERF=y

# Set the FreeRTOS rate to 1ms (1000Hz)
CONFIG_FREERTOS_HZ=1000

CONFIG_ESP_DEFAULT_CPU_FREQ_MHZ_240=y
CONFIG_ESP_DEFAULT_CPU_FREQ_MHZ=240

# Common ESP-related
#
CONFIG_ESP_SYSTEM_EVENT_TASK_STACK_SIZE=4096
CONFIG_ESP_MAIN_TASK_STACK_SIZE=8192

#
# Ethernet (ESP32-Ethernet-Kit A V1.2 — IP101GRI RMII PHY)
#
CONFIG_ETH_ENABLED=y
CONFIG_ETH_USE_ESP32_EMAC=y
CONFIG_ETH_PHY_USE_IP101=y

#
# Partition Table
#
CONFIG_PARTITION_TABLE_CUSTOM=y
CONFIG_PARTITION_TABLE_CUSTOM_FILENAME="partitions.csv"
CONFIG_PARTITION_TABLE_FILENAME="partitions.csv"
CONFIG_PARTITION_TABLE_OFFSET=0x8000
CONFIG_PARTITION_TABLE_MD5=y
```

## components/sdcard/example/main/Kconfig.projbuild
```kconfig
menu "SD Card Example Configuration"

    choice SDCARD_EXAMPLE_INTERFACE
        prompt "Card interface"
        default SDCARD_EXAMPLE_INTERFACE_SDMMC
        help
            How the card is wired: the dedicated SDMMC (SDIO) peripheral, or a
            plain SPI bus (SDSPI). The default pins are the LilyGo T-Dongle-S3's
            microSD slot (SDMMC, 4-bit); change them for your board.

        config SDCARD_EXAMPLE_INTERFACE_SDMMC
            bool "SDMMC (SDIO)"
            depends on SOC_SDMMC_HOST_SUPPORTED
        config SDCARD_EXAMPLE_INTERFACE_SPI
            bool "SPI (SDSPI)"
    endchoice

    if SDCARD_EXAMPLE_INTERFACE_SDMMC
        choice SDCARD_EXAMPLE_SDMMC_BUS_WIDTH
            prompt "Bus width"
            default SDCARD_EXAMPLE_SDMMC_BUS_WIDTH_4
            config SDCARD_EXAMPLE_SDMMC_BUS_WIDTH_4
                bool "4-bit (CLK, CMD, D0-D3)"
            config SDCARD_EXAMPLE_SDMMC_BUS_WIDTH_1
                bool "1-bit (CLK, CMD, D0)"
        endchoice
        config SDCARD_EXAMPLE_SDMMC_CLK
            int "CLK GPIO"
            default 12
        config SDCARD_EXAMPLE_SDMMC_CMD
            int "CMD GPIO"
            default 16
        config SDCARD_EXAMPLE_SDMMC_D0
            int "D0 GPIO"
            default 14
        config SDCARD_EXAMPLE_SDMMC_D1
            int "D1 GPIO (4-bit only)"
            default 17
        config SDCARD_EXAMPLE_SDMMC_D2
            int "D2 GPIO (4-bit only)"
            default 21
        config SDCARD_EXAMPLE_SDMMC_D3
            int "D3 GPIO (4-bit only)"
            default 18
        config SDCARD_EXAMPLE_SDMMC_LDO_CHANNEL
            int "On-chip LDO channel powering the card (-1 = none)"
            default 4 if IDF_TARGET_ESP32P4
            default -1
            help
                The ESP32-P4 powers its SD pads from LDO channel 4 (LDO_VO4).
    endif

    if SDCARD_EXAMPLE_INTERFACE_SPI
        config SDCARD_EXAMPLE_SPI_MOSI
            int "MOSI GPIO"
            default 16
        config SDCARD_EXAMPLE_SPI_MISO
            int "MISO GPIO"
            default 14
        config SDCARD_EXAMPLE_SPI_SCLK
            int "SCLK GPIO"
            default 12
        config SDCARD_EXAMPLE_SPI_CS
            int "CS GPIO"
            default 18
    endif

    config SDCARD_EXAMPLE_FORMAT_IF_MOUNT_FAILED
        bool "Format the card if it has no FAT filesystem"
        default n
        help
            Erases the card. Off by default so an unknown card is never wiped.

endmenu
```
