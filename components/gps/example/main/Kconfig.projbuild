## components/gps/example/main/Kconfig.projbuild
```kconfig
menu "Example Configuration"

choice EXAMPLE_HARDWARE
  prompt "Hardware"
  default EXAMPLE_HARDWARE_CARDPUTER_ADV
  help
    Select the hardware to run this example on.

config EXAMPLE_HARDWARE_CARDPUTER_ADV
  depends on IDF_TARGET_ESP32S3
  bool "M5Stack Cardputer-Adv + LoRa+GPS Cap (ATGM336H)"

config EXAMPLE_HARDWARE_TDECK_PLUS
  depends on IDF_TARGET_ESP32S3
  bool "LilyGo T-Deck Plus (u-blox MIA-M10Q)"

config EXAMPLE_HARDWARE_CUSTOM
  bool "Custom"
endchoice

config EXAMPLE_GPS_RX_GPIO
  int "GPS RX GPIO Num (connected to the receiver's TX)"
  range 0 50
  default 15 if EXAMPLE_HARDWARE_CARDPUTER_ADV
  default 44 if EXAMPLE_HARDWARE_TDECK_PLUS
  default 16 if EXAMPLE_HARDWARE_CUSTOM

config EXAMPLE_GPS_TX_GPIO
  int "GPS TX GPIO Num (connected to the receiver's RX)"
  range 0 50
  default 13 if EXAMPLE_HARDWARE_CARDPUTER_ADV
  default 43 if EXAMPLE_HARDWARE_TDECK_PLUS
  default 17 if EXAMPLE_HARDWARE_CUSTOM

config EXAMPLE_GPS_BAUD_RATE
  int "GPS baud rate"
  range 4800 921600
  default 115200 if EXAMPLE_HARDWARE_CARDPUTER_ADV
  default 9600 if EXAMPLE_HARDWARE_TDECK_PLUS
  default 9600 if EXAMPLE_HARDWARE_CUSTOM

endmenu
```

## components/logger/Kconfig
```kconfig
menu "ESPP Logger"
    config ESPP_LOGGER_LOG_LEVEL
        int "Max Log level"
        default 4
        range 0 4
        help
          Set the log level for the ESPP Logger. The higher the level, the more
          verbose the log output will be. Note that this configuration only affects
          the ESPP logger and not the log level of the ESP-IDF components. Furthermore,
          this configuration will compile-out all log messages below the specified level.

          0 - No log output
          1 - Errors only
          2 - Errors and warnings
          3 - Errors, warnings, and info
          4 - Errors, warnings, info, and debug

    config ESPP_LOGGER_ENABLE_CURSOR_COMMANDS
        bool "Enable cursor commands"
        default y
        help
          Enable cursor commands for the ESPP Logger. This will allow the user to
          move the cursor around the terminal and clear the screen.

    config ESPP_LOGGER_MUTABLE_TAG
        bool "Mutable tag (Logger::set_tag(), BaseComponent::set_log_tag())"
        default n
        help
          Allow a Logger's tag to change after construction, with
          Logger::set_tag() / BaseComponent::set_log_tag(). The tag then needs
          a mutex, and on ESP-IDF each mutex allocates a FreeRTOS semaphore:
          about 116 bytes of internal RAM for every Logger (every espp
          component has one). Off, the tag is set once, in the Logger's
          Config (or BaseComponent's constructor), and set_tag() /
          set_log_tag() do not compile.

endmenu
```

## components/m5stack-cardputer/Kconfig
```kconfig
menu "M5Stack Cardputer Configuration"

    config M5STACK_CARDPUTER_INTERRUPT_STACK_SIZE
        int "Interrupt stack size"
        default 4096
        help
            Size of the stack allocated for the interrupt task.

    config M5STACK_CARDPUTER_INTERRUPT_PRIORITY
        int "Interrupt task priority"
        default 20
        range 0 25
        help
            Priority of the interrupt task.

    config M5STACK_CARDPUTER_INTERRUPT_CORE_ID
        int "Interrupt task core ID"
        default -1
        range -1 1
        help
            Core ID of the interrupt task. -1 means it is not pinned to any core.

    config M5STACK_CARDPUTER_KEYBOARD_TASK_STACK_SIZE
        int "Keyboard task stack size"
        default 8192
        help
            Size of the stack allocated for the keyboard scanner task. Note
            that the keypress callback runs in this task's context, so the
            stack must be large enough for whatever the callback calls into
            (e.g. LVGL).

    config M5STACK_CARDPUTER_KEYBOARD_TASK_PRIORITY
        int "Keyboard task priority"
        default 0
        range 0 25
        help
            Priority of the keyboard scanner task.

    config M5STACK_CARDPUTER_KEYBOARD_TASK_CORE_ID
        int "Keyboard task core ID"
        default -1
        range -1 1
        help
            Core ID of the keyboard scanner task. -1 means it is not pinned to
            any core.

    config M5STACK_CARDPUTER_AUDIO_TASK_STACK_SIZE
        int "Audio task stack size"
        default 4096
        help
            Size of the stack allocated for the audio (speaker) task.

    config M5STACK_CARDPUTER_AUDIO_TASK_PRIORITY
        int "Audio task priority"
        default 19
        range 0 25
        help
            Priority of the audio (speaker) task.

    config M5STACK_CARDPUTER_AUDIO_TASK_CORE_ID
        int "Audio task core ID"
        default 1
        range -1 1
        help
            Core ID of the audio (speaker) task. -1 means it is not pinned to
            any core.

    config M5STACK_CARDPUTER_MICROPHONE_TASK_STACK_SIZE
        int "Microphone task stack size"
        default 4096
        help
            Size of the stack allocated for the microphone task. Note that the
            microphone callback runs in this task's context, so the stack must
            be large enough for whatever the callback does with the audio data.

    config M5STACK_CARDPUTER_MICROPHONE_TASK_PRIORITY
        int "Microphone task priority"
        default 19
        range 0 25
        help
            Priority of the microphone task.

    config M5STACK_CARDPUTER_MICROPHONE_TASK_CORE_ID
        int "Microphone task core ID"
        default 1
        range -1 1
        help
            Core ID of the microphone task. -1 means it is not pinned to any
            core.

endmenu
```

## components/m5stack-tab5/Kconfig
```kconfig
menu "M5Stack Tab5 Configuration"
  config M5STACK_TAB5_INTERRUPT_STACK_SIZE
  int "Interrupt stack size"
  default 4096
  help
    Size of the stack used for the interrupt handler. Used by the touch
    callback and other interrupt handlers.

  config M5STACK_TAB5_INTERRUPT_PRIORITY
  int "Interrupt task priority"
  default 0
  range 0 25
  help
    FreeRTOS priority of the GPIO interrupt handler task (0 = lowest). Raise it
    if interrupt callbacks must run promptly relative to other tasks.

  config M5STACK_TAB5_INTERRUPT_CORE_ID
  int "Interrupt task core ID"
  default -1
  range -1 1
  help
    Core to pin the GPIO interrupt handler task to (-1 = not pinned to any core).

  config M5STACK_TAB5_AUDIO_TASK_STACK_SIZE
  int "Audio task stack size"
  default 8192
  help
    Size of the stack used for the audio processing task.

  config M5STACK_TAB5_ST7121_HW_ROTATION
    bool "ST7121: apply 0/180 rotation in the panel (EXPERIMENTAL)"
    default n
    help
      Route 0/180-degree display rotation to the ST7121 panel itself (MADCTL
      GS/SS scan-direction flip) instead of the PPA/software rotation in the
      flush path. EXPERIMENTAL: verified NOT working on at least some ST7121
      Tab5 units - the 180-degree orientation renders corrupted, most likely
      because the TDDI gate/source mux tables programmed at init (command
      0xAC block) are matched to the normal scan direction and a MADCTL GS
      flip alone reorders gate scanning without swapping them. Leave disabled
      (the default) to keep the known-good PPA rotation for all orientations;
      enable only to experiment on your unit.

  config M5STACK_TAB5_ROTATION_SOFTWARE_FALLBACK
    bool "Keep a software fallback for display rotation"
    default y
    help
      Display rotation normally runs on the PPA, which rotates each flushed
      area straight into the panel framebuffer. When the PPA is unavailable
      (its client or completion callback could not be registered, or an
      operation fails) the area is instead rotated on the CPU into a scratch
      buffer the size of the LVGL draw buffer (1.8 MB of PSRAM with the
      example's full-frame draw buffers). That scratch buffer is allocated
      the first time the fallback is needed, so on a board where the PPA
      works it costs nothing. Disable to never allocate it: rotation is then
      PPA-only, and a rotated flush with no PPA available is dropped with an
      error instead of being rotated in software.

  config M5STACK_TAB5_DPI_NUM_FBS
  int "Number of DPI frame buffers"
  default 1
  range 1 3
  help
    How many frame buffers the MIPI-DSI DPI panel driver allocates in PSRAM
    (esp_lcd_dpi_panel_config_t::num_fbs). Each one is 720 x 1280 RGB565 =
    1.8 MB of PSRAM, so every buffer beyond the first costs 1.8 MB.
    With 1 (the default) LVGL renders into separate draw buffers and the BSP
    copies each flushed area into the one frame buffer the panel scans out.
    With 2 or 3 the application can render straight into the frame buffers
    and switch whole frames instead of copying them: see
    M5StackTab5::frame_buffers() and
    DisplayConfig::render_to_frame_buffers_enabled. LVGL's DIRECT mode uses
    at most two of them (buffers 1 and 0); a third only serves an
    application that drives the frame buffers itself. Extra buffers without
    DIRECT mode buy nothing: LVGL keeps copying into the scanned-out buffer.

  config M5STACK_TAB5_BACK_BUFFER_FLUSH
  bool "Compile in the back-buffer LVGL flush (tear-free with rotation)"
  depends on M5STACK_TAB5_DPI_NUM_FBS > 1
  default n
  help
    Compile in DisplayConfig::flush_to_back_buffer_enabled: LVGL keeps its
    draw buffers, every flushed area is copied (DMA2D; PPA when rotated)
    into the frame buffer the panel is not scanning out, and the panel
    switches to it at the frame boundary once the frame is complete, so
    frames never tear and the display rotation keeps working (unlike
    LVGL's DIRECT mode). Off, nothing of it is built: the flush path is
    unchanged and initialize_display() refuses the option. On, it is still
    opt-in per display (the DisplayConfig flag defaults to off; nothing is
    allocated or installed until it is set). Needs 2 frame buffers (1.8 MB
    of PSRAM for the second) and the PPA; a full-screen redraw then takes
    two panel periods (the frame-done wait) and the draw buffers can be
    small strips: see the README's measurements.

endmenu
```

## components/m5stack-tab5/example/main/Kconfig.projbuild
```kconfig
menu "M5Stack Tab5 Example Configuration"

    config M5STACK_TAB5_EXAMPLE_RENDER_TO_FRAME_BUFFERS
        bool "Render LVGL straight into the panel's frame buffers"
        depends on M5STACK_TAB5_DPI_NUM_FBS > 1
        default n
        help
            Initialize the display with
            DisplayConfig::render_to_frame_buffers_enabled: LVGL renders in DIRECT
            mode straight into the DPI panel's frame buffers and a finished
            frame is shown by switching the panel to it, instead of copying
            LVGL's draw buffers into the one frame buffer the panel scans
            out. Saves the two draw buffers and the rotation scratch buffer
            (PSRAM) and the copy on every flush. Needs
            CONFIG_M5STACK_TAB5_DPI_NUM_FBS >= 2 (M5Stack Tab5 Configuration).
            The rotate button does nothing in this mode: LVGL cannot rotate in
            DIRECT mode.

    config M5STACK_TAB5_EXAMPLE_FLUSH_TO_BACK_BUFFER
        bool "Flush LVGL into the back frame buffer (tear-free, rotation works)"
        depends on M5STACK_TAB5_DPI_NUM_FBS > 1 && !M5STACK_TAB5_EXAMPLE_RENDER_TO_FRAME_BUFFERS
        default n
        help
            Initialize the display with
            DisplayConfig::flush_to_back_buffer_enabled: every LVGL flush is
            copied (and rotated) by the PPA into the frame buffer the panel is
            not scanning out, and the panel switches to it at the frame
            boundary once the frame is complete. Partial frames are never on
            screen, so the draw buffers can be strips (see
            M5STACK_TAB5_EXAMPLE_DRAW_BUFFER_LINES) and a full-screen redraw
            still appears at once. The rotate button works. Needs
            CONFIG_M5STACK_TAB5_DPI_NUM_FBS >= 2 (M5Stack Tab5 Configuration).

    config M5STACK_TAB5_EXAMPLE_DRAW_BUFFER_LINES
        int "Rows per LVGL draw buffer"
        depends on !M5STACK_TAB5_EXAMPLE_RENDER_TO_FRAME_BUFFERS
        range 8 1280
        default 1280
        help
            Height, in panel rows of 720 pixels, of each of LVGL's two draw
            buffers; 1280 is a whole frame (1.8 MB of PSRAM each). With one
            frame buffer a full-screen redraw flushes strip by strip into the
            buffer on screen, so a whole-frame draw buffer is what makes it
            appear at once; with the back-buffer flush the strips are
            assembled off screen and a far smaller draw buffer (e.g. 128 rows,
            184 KB, the BSP's default strip) looks the same and leaves the
            PSRAM to the application.

endmenu
```

## components/meshtastic/example/main/Kconfig.projbuild
```kconfig
menu "Example Configuration"

choice EXAMPLE_HARDWARE
  prompt "Hardware"
  default EXAMPLE_HARDWARE_TDECK
  help
    Select the board to run this example on. Both use an SX1262 LoRa radio
    exposed through the board's BSP component.

config EXAMPLE_HARDWARE_TDECK
  depends on IDF_TARGET_ESP32S3
  bool "LilyGo T-Deck / T-Deck Plus"

config EXAMPLE_HARDWARE_CARDPUTER_ADV
  depends on IDF_TARGET_ESP32S3
  bool "M5Stack Cardputer-Adv + LoRa+GPS Cap"
endchoice

choice EXAMPLE_REGION
  prompt "LoRa region"
  default EXAMPLE_REGION_US
  help
    The LoRa regulatory region. This MUST match the region of the Meshtastic
    devices you want to talk to, and must be legal where you are.

config EXAMPLE_REGION_US
  bool "US (902-928 MHz)"

config EXAMPLE_REGION_EU_868
  bool "EU 868 (869 MHz)"

config EXAMPLE_REGION_ANZ
  bool "Australia / New Zealand (915-928 MHz)"
endchoice

config EXAMPLE_LONG_NAME
  string "Node long name"
  default "espp node"

config EXAMPLE_SHORT_NAME
  string "Node short name (<= 4 chars)"
  default "espp"

config EXAMPLE_REBROADCAST
  bool "Rebroadcast (relay) other nodes' packets"
  default n
  help
    Whether to act as a mesh router and rebroadcast packets from other nodes
    (managed flood). Leave off for a simple receive/originate-only node,
    which still fully interoperates.

config EXAMPLE_TEXT_INTERVAL_S
  int "Text ping interval (seconds, 0 to disable)"
  default 30

config EXAMPLE_NODEINFO_INTERVAL_S
  int "Node info broadcast interval (seconds)"
  default 300

endmenu
```

## components/mt6701/Kconfig
```kconfig
menu "MT6701 Configuration"
    config MT6701_MIN_DIFF
        int "Minimum difference for velocity calculation"
        default 2
        range 0 100
        help
          Set the minimum difference in encoder counts required to update
          the velocity calculation. If the absolute difference between the
          current and previous count is less than or equal to this value,
          the velocity will be set to 0. This helps filter out noise and
          small jitter in the encoder readings.

    config MT6701_USE_HIGH_RESOLUTION_TIMER
        bool "Use high resolution timer instead of software timer"
        default y
        help
          Drive the periodic encoder update with an esp_timer-backed
          HighResolutionTimer (microsecond resolution). This is the right
          choice for sub-millisecond update periods. Disable this to instead
          use an espp::Timer, which schedules against an absolute wake-up time
          (drift-free and in phase) but is limited to the FreeRTOS tick
          resolution.

endmenu
```
