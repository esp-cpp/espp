## components/adxl345/example/main/Kconfig.projbuild
```kconfig
menu "Example Configuration"

    choice EXAMPLE_HARDWARE
        prompt "Hardware"
        default EXAMPLE_HARDWARE_QTPYS3
        help
            Select the hardware to run this example on.

        config EXAMPLE_HARDWARE_QTPYPICO
            depends on IDF_TARGET_ESP32
            bool "Qt Py PICO"

        config EXAMPLE_HARDWARE_QTPYS3
            depends on IDF_TARGET_ESP32S3
            bool "Qt Py S3"

        config EXAMPLE_HARDWARE_BYTE90
            depends on IDF_TARGET_ESP32S3
            bool "Byte 90"

        config EXAMPLE_HARDWARE_CUSTOM
            bool "Custom"
    endchoice

    config EXAMPLE_ALERT_GPIO
        int "Alert GPIO Num"
        range 0 50
        default 2 if EXAMPLE_HARDWARE_BYTE90
        default 18
        help
            GPIO number for alert pin.

    config EXAMPLE_I2C_SCL_GPIO
        int "SCL GPIO Num"
        range 0 50
        default 19 if EXAMPLE_HARDWARE_QTPYPICO
        default 40 if EXAMPLE_HARDWARE_QTPYS3
        default 6 if EXAMPLE_HARDWARE_BYTE90
        default 19 if EXAMPLE_HARDWARE_CUSTOM
        help
            GPIO number for I2C Master clock line.

    config EXAMPLE_I2C_SDA_GPIO
        int "SDA GPIO Num"
        range 0 50
        default 22 if EXAMPLE_HARDWARE_QTPYPICO
        default 41 if EXAMPLE_HARDWARE_QTPYS3
        default 5 if EXAMPLE_HARDWARE_BYTE90
        default 22 if EXAMPLE_HARDWARE_CUSTOM
        help
            GPIO number for I2C Master data line.

endmenu
```

## components/android_tv_remote/example/main/Kconfig.projbuild
```kconfig
menu "Android TV Remote Example Configuration"

    config ANDROID_TV_REMOTE_EXAMPLE_WIFI_SSID
        string "WiFi SSID"
        default ""
        help
            WiFi SSID for the example. Leave empty to use saved station credentials.

    config ANDROID_TV_REMOTE_EXAMPLE_WIFI_PASSWORD
        string "WiFi password"
        default ""
        help
            WiFi password for the example. Leave empty to use saved station credentials.

    config ANDROID_TV_REMOTE_EXAMPLE_TARGET_HOST
        string "Target host override"
        default ""
        help
            Optional IPv4 address or hostname of the Android TV / Google TV device.

    config ANDROID_TV_REMOTE_EXAMPLE_ENABLE_DISCOVERY
        bool "Enable mDNS discovery"
        default y

    config ANDROID_TV_REMOTE_EXAMPLE_PAIR_IF_CONFIGURED
        bool "Attempt pairing when a host and pairing code are configured"
        default n

    config ANDROID_TV_REMOTE_EXAMPLE_PAIRING_CODE
        string "Pairing code"
        default ""
        help
            Six-character hexadecimal pairing code shown on the TV during pairing.

    config ANDROID_TV_REMOTE_EXAMPLE_CLIENT_NAME
        string "Client display name"
        default "ESPP Android TV Remote"

    config ANDROID_TV_REMOTE_EXAMPLE_PERSISTENCE_NAMESPACE
        string "NVS namespace"
        default "atvremote"
        help
            Namespace used to persist the client certificate and private key.

    config ANDROID_TV_REMOTE_EXAMPLE_ENABLE_IME
        bool "Enable IME text input support"
        default y

endmenu
```

## components/at581x/example/main/Kconfig.projbuild
```kconfig
menu "Example Configuration"

    choice EXAMPLE_HARDWARE
        prompt "Hardware"
        default EXAMPLE_HARDWARE_BOX3_SENSOR
        help
            Select the hardware to run this example on.

        config EXAMPLE_HARDWARE_BOX3_SENSOR
            depends on IDF_TARGET_ESP32S3
            bool "ESP32-S3-BOX-3 sensor dock"

        config EXAMPLE_HARDWARE_CUSTOM
            bool "Custom"
    endchoice

    config EXAMPLE_I2C_SCL_GPIO
        int "SCL GPIO Num"
        range 0 50
        default 40 if EXAMPLE_HARDWARE_BOX3_SENSOR
        default 40 if EXAMPLE_HARDWARE_CUSTOM
        help
            GPIO number for I2C Master clock line.

    config EXAMPLE_I2C_SDA_GPIO
        int "SDA GPIO Num"
        range 0 50
        default 41 if EXAMPLE_HARDWARE_BOX3_SENSOR
        default 41 if EXAMPLE_HARDWARE_CUSTOM
        help
            GPIO number for I2C Master data line.

    config EXAMPLE_RADAR_OUTPUT_GPIO
        int "Radar output GPIO Num (-1 to disable presence interrupt)"
        range -1 50
        default 21 if EXAMPLE_HARDWARE_BOX3_SENSOR
        default -1 if EXAMPLE_HARDWARE_CUSTOM
        help
            GPIO number connected to the AT581X active-high presence/motion
            output pin. On the ESP32-S3-BOX-3 sensor dock this is GPIO21 (verify
            for your board revision). If set to -1, the presence interrupt is
            disabled and the example only exercises the I2C configuration.

endmenu
```

## components/at581x/example/sdkconfig.defaults
```kconfig
CONFIG_IDF_TARGET="esp32s3"

CONFIG_FREERTOS_HZ=1000

CONFIG_COMPILER_CXX_EXCEPTIONS=y
CONFIG_COMPILER_OPTIMIZATION_PERF=y

# ESP32-S3-BOX-3 has 16MB flash; use QIO for speed.
CONFIG_ESPTOOLPY_FLASHSIZE_16MB=y
CONFIG_ESPTOOLPY_FLASHSIZE="16MB"
CONFIG_ESPTOOLPY_FLASHMODE_QIO=y

CONFIG_ESP_DEFAULT_CPU_FREQ_MHZ_240=y
CONFIG_ESP_DEFAULT_CPU_FREQ_MHZ=240

# Larger stacks for the LVGL / display BSP used on the box-3.
CONFIG_ESP_SYSTEM_EVENT_TASK_STACK_SIZE=4096
CONFIG_ESP_MAIN_TASK_STACK_SIZE=16384
CONFIG_ESP_TIMER_TASK_STACK_SIZE=6144

CONFIG_SPI_MASTER_IN_IRAM=y

# LVGL configuration (used when targeting the ESP32-S3-BOX-3 display).
CONFIG_LV_DEF_REFR_PERIOD=16
CONFIG_LV_USE_THEME_DEFAULT=y
CONFIG_LV_THEME_DEFAULT_DARK=y
```

## components/at581x/example/sdkconfig.defaults.esp32s3
```kconfig
# on the ESP32S3, which has native USB, set the console so output works over USB:
CONFIG_ESP_CONSOLE_USB_SERIAL_JTAG=y
```

## components/binary-log/example/sdkconfig.defaults
```kconfig
CONFIG_IDF_TARGET="esp32s3"

# Common ESP-related
#
# binary_log requires exceptions right now...
# CONFIG_COMPILER_CXX_EXCEPTIONS=y

CONFIG_ESPTOOLPY_FLASHSIZE_4MB=y
CONFIG_ESPTOOLPY_FLASHSIZE="4MB"

CONFIG_FREERTOS_HZ=1000

# Clock Frequency
CONFIG_ESP_DEFAULT_CPU_FREQ_MHZ_240=y
CONFIG_ESP_DEFAULT_CPU_FREQ_MHZ=240

# Common ESP-related
#
CONFIG_ESP_SYSTEM_EVENT_TASK_STACK_SIZE=4096
CONFIG_ESP_MAIN_TASK_STACK_SIZE=6144
CONFIG_ESP_TIMER_TASK_STACK_SIZE=4096

# Partition Table
CONFIG_PARTITION_TABLE_CUSTOM=y
CONFIG_PARTITION_TABLE_CUSTOM_FILENAME="partitions.csv"

# Even if the environment variable MEMFAULT_DISABLE=1 is set, cli.py can retrieve SystemInfo.
CONFIG_FREERTOS_USE_TRACE_FACILITY=y
CONFIG_FREERTOS_GENERATE_RUN_TIME_STATS=y

# Coredump
CONFIG_ESP_COREDUMP_ENABLE_TO_FLASH=y
CONFIG_ESP_COREDUMP_STACK_SIZE=2048
```

## components/bldc_current_sense/example/sdkconfig.defaults
```kconfig
CONFIG_IDF_TARGET="esp32s3"

CONFIG_COMPILER_OPTIMIZATION_PERF=y

CONFIG_FREERTOS_HZ=1000

CONFIG_ESPTOOLPY_FLASHSIZE_8MB=y
CONFIG_ESPTOOLPY_FLASHSIZE="8MB"

CONFIG_ESP_DEFAULT_CPU_FREQ_MHZ_240=y
CONFIG_ESP_DEFAULT_CPU_FREQ_MHZ=240

CONFIG_ESP_SYSTEM_EVENT_TASK_STACK_SIZE=4096
CONFIG_ESP_MAIN_TASK_STACK_SIZE=8192
```

## components/bldc_haptics/example/main/Kconfig.projbuild
```kconfig
menu "Example Configuration"

    choice EXAMPLE_HARDWARE
        prompt "Hardware"
        default EXAMPLE_HARDWARE_TEST_STAND
        help
            Select the hardware to run this example on.

        config EXAMPLE_HARDWARE_TEST_STAND
            depends on IDF_TARGET_ESP32S3
            bool "BLDC Motor Test Stand (TinyS3)"

        config EXAMPLE_HARDWARE_MOTORGO_MINI
            depends on IDF_TARGET_ESP32S3
            bool "MotorGo Mini"

        config EXAMPLE_HARDWARE_MOTORGO_AXIS
            depends on IDF_TARGET_ESP32S3
            bool "MotorGo Axis"

        config EXAMPLE_HARDWARE_CUSTOM
            bool "Custom"
    endchoice

    choice EXAMPLE_MOTOR_CHANNEL
        prompt "Motor channel"
        depends on EXAMPLE_HARDWARE_MOTORGO_MINI || EXAMPLE_HARDWARE_MOTORGO_AXIS
        default EXAMPLE_MOTOR_CHANNEL_1
        help
            Select which motor channel of the MotorGo board to drive.

        config EXAMPLE_MOTOR_CHANNEL_1
            bool "Motor 1"

        config EXAMPLE_MOTOR_CHANNEL_2
            bool "Motor 2"
    endchoice

    config EXAMPLE_I2C_SCL_GPIO
        int "SCL GPIO Num"
        range 0 50
        default 9 if EXAMPLE_HARDWARE_TEST_STAND
        default 19 if EXAMPLE_HARDWARE_CUSTOM
        default 0
        depends on EXAMPLE_HARDWARE_TEST_STAND || EXAMPLE_HARDWARE_CUSTOM
        help
            GPIO number for I2C Master clock line. Only used for the test-stand /
            custom wiring; the MotorGo boards use their own SSI encoder bus.

    config EXAMPLE_I2C_SDA_GPIO
        int "SDA GPIO Num"
        range 0 50
        default 8 if EXAMPLE_HARDWARE_TEST_STAND
        default 22 if EXAMPLE_HARDWARE_CUSTOM
        default 0
        depends on EXAMPLE_HARDWARE_TEST_STAND || EXAMPLE_HARDWARE_CUSTOM
        help
            GPIO number for I2C Master data line. Only used for the test-stand /
            custom wiring; the MotorGo boards use their own SSI encoder bus.

endmenu
```

## components/bldc_motor/example/main/Kconfig.projbuild
```kconfig
menu "Example Configuration"

    choice EXAMPLE_HARDWARE
        prompt "Hardware"
        default EXAMPLE_HARDWARE_TEST_STAND
        help
            Select the hardware to run this example on.

        config EXAMPLE_HARDWARE_TEST_STAND
            depends on IDF_TARGET_ESP32S3
            bool "BLDC Motor Test Stand (TinyS3)"

        config EXAMPLE_HARDWARE_CUSTOM
            bool "Custom"
    endchoice

    config EXAMPLE_I2C_SCL_GPIO
        int "SCL GPIO Num"
        range 0 50
        default 9 if EXAMPLE_HARDWARE_TEST_STAND
        default 19 if EXAMPLE_HARDWARE_CUSTOM
        help
            GPIO number for I2C Master clock line.

    config EXAMPLE_I2C_SDA_GPIO
        int "SDA GPIO Num"
        range 0 50
        default 8 if EXAMPLE_HARDWARE_TEST_STAND
        default 22 if EXAMPLE_HARDWARE_CUSTOM
        help
            GPIO number for I2C Master data line.

endmenu
```

## components/bm8563/example/main/Kconfig.projbuild
```kconfig
menu "Example Configuration"

    choice EXAMPLE_HARDWARE
        prompt "Hardware"
        default EXAMPLE_HARDWARE_TIMERCAM
        help
            Select the hardware to run this example on.

        config EXAMPLE_HARDWARE_TIMERCAM
            depends on IDF_TARGET_ESP32
            bool "ESP32 TimerCam

        config EXAMPLE_HARDWARE_CUSTOM
            bool "Custom"
    endchoice

    config EXAMPLE_I2C_SCL_GPIO
        int "SCL GPIO Num"
        range 0 50
        default 14 if EXAMPLE_HARDWARE_TIMERCAM
        default 19 if EXAMPLE_HARDWARE_CUSTOM
        help
            GPIO number for I2C Master clock line.

    config EXAMPLE_I2C_SDA_GPIO
        int "SDA GPIO Num"
        range 0 50
        default 12 if EXAMPLE_HARDWARE_TIMERCAM
        default 22 if EXAMPLE_HARDWARE_CUSTOM
        help
            GPIO number for I2C Master data line.

endmenu
```

## components/byte90/Kconfig
```kconfig
menu "Byte90 Configuration"
    config BYTE90_INTERRUPT_STACK_SIZE
        int "Interrupt stack size"
        default 4096
        help
            Size of the stack used for the interrupt handler. Shared by the
            keyboard callback and the touch callback.

    config BYTE90_INTERRUPT_PRIORITY
        int "Interrupt task priority"
        default 20
        range 0 25
        help
            FreeRTOS priority of the GPIO interrupt handler task (0 = lowest). Raise it
            if interrupt callbacks must run promptly relative to other tasks.

    config BYTE90_INTERRUPT_CORE_ID
        int "Interrupt task core ID"
        default -1
        range -1 1
        help
            Core to pin the GPIO interrupt handler task to (-1 = not pinned to any core).
endmenu
```

## components/chsc6x/example/main/Kconfig.projbuild
```kconfig
menu "Example Configuration"

    choice EXAMPLE_HARDWARE
        prompt "Hardware"
        default EXAMPLE_HARDWARE_XIAOS3
        help
            Select the hardware to run this example on.

        config EXAMPLE_HARDWARE_XIAOS3
            depends on IDF_TARGET_ESP32S3
            bool "XIAO-S3"

        config EXAMPLE_HARDWARE_QTPYS3
            depends on IDF_TARGET_ESP32S3
            bool "QTPY ESP32 S3"

        config EXAMPLE_HARDWARE_CUSTOM
            bool "Custom"
    endchoice

    config EXAMPLE_I2C_SCL_GPIO
        int "SCL GPIO Num"
        range 0 50
        default 6 if EXAMPLE_HARDWARE_XIAOS3
        default 6 if EXAMPLE_HARDWARE_QTPYS3
        default 19 if EXAMPLE_HARDWARE_CUSTOM
        help
            GPIO number for I2C Master clock line.

    config EXAMPLE_I2C_SDA_GPIO
        int "SDA GPIO Num"
        range 0 50
        default 5 if EXAMPLE_HARDWARE_XIAOS3
        default 7 if EXAMPLE_HARDWARE_QTPYS3
        default 22 if EXAMPLE_HARDWARE_CUSTOM
        help
            GPIO number for I2C Master data line.

endmenu
```

## components/cli/example/sdkconfig.defaults.esp32s2
```kconfig
# on the ESP32S2, which has native USB, we need to set the console so that the
# CLI can be configured correctly:
CONFIG_ESP_CONSOLE_USB_CDC=y
```

## components/cst816/example/main/Kconfig.projbuild
```kconfig
menu "Example Configuration"

    choice EXAMPLE_HARDWARE
        prompt "Hardware"
        default EXAMPLE_HARDWARE_MATOUCH_ROTARY_DISPLAY
        help
            Select the hardware to run this example on.

        config EXAMPLE_HARDWARE_MATOUCH_ROTARY_DISPLAY
            depends on IDF_TARGET_ESP32S3
            bool "ESP32-S3 Matouch Rotary Display"

        config EXAMPLE_HARDWARE_CUSTOM
            bool "Custom"
    endchoice

    config EXAMPLE_I2C_SCL_GPIO
        int "SCL GPIO Num"
        range 0 50
        default 39 if EXAMPLE_HARDWARE_MATOUCH_ROTARY_DISPLAY
        default 19 if EXAMPLE_HARDWARE_CUSTOM
        help
            GPIO number for I2C Master clock line.

    config EXAMPLE_I2C_SDA_GPIO
        int "SDA GPIO Num"
        range 0 50
        default 38 if EXAMPLE_HARDWARE_MATOUCH_ROTARY_DISPLAY
        default 22 if EXAMPLE_HARDWARE_CUSTOM
        help
            GPIO number for I2C Master data line.

endmenu
```

## components/display_drivers/example/main/Kconfig.projbuild
```kconfig
menu "Display Drivers Example Configuration"

    choice
        prompt "Hardware Configuration"
        default HARDWARE_WROVER_KIT
        help
            Select the dev-kit / hardware you're using.
        config HARDWARE_WROVER_KIT
            bool "ESP32 WROVER KIT V4"
        config HARDWARE_TTGO
            bool "TTGO T-DISPLAY"
        config HARDWARE_BOX
            bool "ESP BOX"
        config SMARTKNOB_HA
            bool "SMARTKNOB-HA"
        config T_ENCODER_PRO
            bool "T-ENCODER-PRO"
        config HARDWARE_BYTE90
            bool "ALXV Labs Byte90"
    endchoice

    config DISPLAY_QUAD_SPI
        bool "Quad SPI"
        default y if T_ENCODER_PRO
        help
            Use a Quad SPI bus for the display

endmenu
```

## components/display_drivers/example/sdkconfig.defaults
```kconfig
CONFIG_ESPTOOLPY_FLASHSIZE_4MB=y
CONFIG_ESPTOOLPY_FLASHSIZE="4MB"

# Common ESP-related
#
CONFIG_ESP_SYSTEM_EVENT_TASK_STACK_SIZE=4096
CONFIG_ESP_MAIN_TASK_STACK_SIZE=8192

# ESP32-specific
#
CONFIG_ESP_DEFAULT_CPU_FREQ_240=y
CONFIG_ESP_DEFAULT_CPU_FREQ_MHZ=240

#
# LVGL configuration - # Monitoring
#
CONFIG_LV_USE_PERF_MONITOR=y
CONFIG_LV_USE_MEM_MONITOR=y

#
# LVGL configuration - # Themes
#
CONFIG_LV_USE_THEME_DEFAULT=y
CONFIG_LV_THEME_DEFAULT_DARK=y
CONFIG_LV_THEME_DEFAULT_GROW=y
CONFIG_LV_THEME_DEFAULT_TRANSITION_TIME=80
CONFIG_LV_MEM_SIZE_KILOBYTES=64
```

## components/esp-box/Kconfig
```kconfig
menu "Esp-Box Configuration"
    config ESP_BOX_INTERRUPT_STACK_SIZE
        int "Interrupt stack size"
        default 4096
        help
            Size of the stack used for the interrupt handler. Used by the touch
            callback.
endmenu
```
