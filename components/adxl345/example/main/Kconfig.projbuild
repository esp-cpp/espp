## components/esp32-p4-function-ev-board/Kconfig
```kconfig
menu "ESP32-P4 Function EV Board Configuration"

  choice ESP_P4_EV_BOARD_DISPLAY
    prompt "HMI subboard display panel (fallback/default)"
    default ESP_P4_EV_BOARD_DISPLAY_EK79007
    help
      The BSP probes the attached MIPI-DSI panel at runtime (it reads the
      ILI9881C ID over DSI and otherwise assumes EK79007), so this choice is only
      the fallback used if probing is inconclusive. Set it to the panel you
      normally use.

    config ESP_P4_EV_BOARD_DISPLAY_EK79007
      bool "EK79007 (7-inch, 1024x600)"
      help
        The 7-inch 1024x600 panel that ships with the standard
        ESP32-P4-Function-EV-Board kit. Backlight on GPIO26, reset on GPIO27.

    config ESP_P4_EV_BOARD_DISPLAY_ILI9881C
      bool "ILI9881C (10.1-inch, 800x1280)"
      help
        The 10.1-inch 800x1280 panel variant. Backlight on GPIO23, reset is not
        connected (handled over DSI).
  endchoice

  config ESP_P4_EV_BOARD_INTERRUPT_STACK_SIZE
    int "Interrupt task stack size (bytes)"
    default 4096
    help
      Size of the stack used for the GPIO interrupt handler task (button, etc.).

  config ESP_P4_EV_BOARD_TOUCH_TASK_STACK_SIZE
    int "Touch polling task stack size (bytes)"
    default 4096
    help
      Size of the stack used for the GT911 touch polling task. Used only in
      polling mode (see ESP_P4_EV_BOARD_TOUCH_INTERRUPT).

  config ESP_P4_EV_BOARD_TOUCH_INTERRUPT
    bool "Use interrupt-driven touch instead of polling"
    default n
    help
      By default the ESP32-P4-HMI-Subboard does not route the GT911 touch INT pin
      to the ESP32-P4, so touch is polled in a task. The LCD expansion header does
      expose the touch INT pin: if you wire it to a free ESP32-P4 GPIO, enable this
      to read the GT911 from a GPIO interrupt instead of polling (lower CPU usage
      and latency). The GPIO is set below, and can also be overridden at runtime
      via initialize_touch().

  config ESP_P4_EV_BOARD_TOUCH_INTERRUPT_GPIO
    int "Touch interrupt GPIO"
    depends on ESP_P4_EV_BOARD_TOUCH_INTERRUPT
    default 33
    help
      GPIO that the GT911 touch INT pin (from the LCD expansion header) is wired
      to. Must be a free GPIO not used by another on-board peripheral.

  config ESP_P4_EV_BOARD_AUDIO_TASK_STACK_SIZE
    int "Audio task stack size (bytes)"
    default 8192
    help
      Size of the stack used for the audio processing task.

  config ESP_P4_EV_BOARD_ETHERNET
    bool "Enable Ethernet (IP101 RMII) support"
    default y
    help
      Build the Ethernet (EMAC + IP101 RMII PHY) support in the BSP. Disable to
      drop the esp_eth dependency if you do not need wired networking.

endmenu
```

## components/esp32-p4-function-ev-board/example/sdkconfig.defaults
```kconfig
# ESP32-P4 specific configuration
CONFIG_IDF_TARGET="esp32p4"
# for ESP-IDF >= v6.0, we have to set this to allow older boards (e.g. this dev
# board) to work with the newer ESP-IDF since it's using an older p4 chip
# revision
CONFIG_ESP32P4_SELECTS_REV_LESS_V3=y

# CONFIG_COMPILER_OPTIMIZATION_PERF=y

CONFIG_ESPTOOLPY_FLASHMODE_QIO=y
CONFIG_ESPTOOLPY_FLASHSIZE_16MB=y
CONFIG_ESPTOOLPY_FLASHSIZE="16MB"

# Memory configuration
CONFIG_ESP_MAIN_TASK_STACK_SIZE=32768
CONFIG_ESP_SYSTEM_EVENT_TASK_STACK_SIZE=4096
CONFIG_ESP_TIMER_TASK_STACK_SIZE=6144

# Ensure eth is enabled
CONFIG_ETH_ENABLED=y
CONFIG_ETH_USE_ESP32_EMAC=y

#
# Partition Table
#
CONFIG_PARTITION_TABLE_CUSTOM=y
CONFIG_PARTITION_TABLE_OFFSET=0x9000
CONFIG_PARTITION_TABLE_CUSTOM_FILENAME="partitions.csv"

# FreeRTOS
CONFIG_FREERTOS_HZ=1000

# Copy received Ethernet frames into a fresh lwip pbuf instead of referencing the
# EMAC DMA buffer directly. This avoids cache-coherency issues with the EMAC RX
# DMA on the ESP32-P4 (which can silently drop/corrupt unicast frames while
# broadcast/multicast appear to work, e.g. DHCP succeeds but ping fails).
# CONFIG_LWIP_L2_TO_L3_COPY=y

# PSRAM (required for the MIPI-DSI frame buffers)
CONFIG_SPIRAM=y
CONFIG_SPIRAM_SPEED_200M=y
CONFIG_SPIRAM_XIP_FROM_PSRAM=y
CONFIG_CACHE_L2_CACHE_256KB=y
CONFIG_CACHE_L2_CACHE_LINE_128B=y

# LVGL configuration
CONFIG_LV_DEF_REFR_PERIOD=16
CONFIG_LV_USE_THEME_DEFAULT=y
CONFIG_LV_THEME_DEFAULT_DARK=y
CONFIG_LV_THEME_DEFAULT_GROW=y
CONFIG_LV_THEME_DEFAULT_TRANSITION_TIME=30

# ESP32-P4 Function EV Board BSP configuration
CONFIG_ESP_P4_EV_BOARD_INTERRUPT_STACK_SIZE=4096
CONFIG_ESP_P4_EV_BOARD_TOUCH_TASK_STACK_SIZE=4096
CONFIG_ESP_P4_EV_BOARD_AUDIO_TASK_STACK_SIZE=8192
```

## components/esp32-timer-cam/Kconfig
```kconfig
menu "Esp32 TimerCam Configuration"
    config ESP_TIMER_CAM_INTERRUPT_STACK_SIZE
        int "Interrupt stack size"
        default 4096
        help
            Size of the stack used for the interrupt handler.

    config ESP_TIMER_CAM_INTERRUPT_PRIORITY
        int "Interrupt task priority"
        default 0
        range 0 25
        help
            FreeRTOS priority of the GPIO interrupt handler task (0 = lowest). Raise it
            if interrupt callbacks must run promptly relative to other tasks.

    config ESP_TIMER_CAM_INTERRUPT_CORE_ID
        int "Interrupt task core ID"
        default -1
        range -1 1
        help
            Core to pin the GPIO interrupt handler task to (-1 = not pinned to any core).
endmenu
```

## components/esp32-timer-cam/example/main/Kconfig.projbuild
```kconfig
menu "Camera Streamer Configuration"

    config RTSP_SERVER_PORT
        int "RTSP Server Port"
        default 8554
        help
            The port number of the RTSP server.

    config ESP_WIFI_SSID
        string "WiFi SSID"
        default ""
        help
            SSID (network name) for the camera streamer to connect to.

    config ESP_WIFI_PASSWORD
        string "WiFi Password"
        default ""
        help
            WiFi password (WPA or WPA2) for the camera streamer to use.

    config ESP_MAXIMUM_RETRY
        int "Maximum retry"
        default 5
        help
            Set the Maximum retry to avoid station reconnecting to the AP unlimited when the AP is really inexistent.

endmenu
```

## components/esp32-timer-cam/example/sdkconfig.defaults
```kconfig
CONFIG_IDF_TARGET="esp32"

CONFIG_COMPILER_OPTIMIZATION_PERF=y
# CONFIG_COMPILER_OPTIMIZATION_SIZE=y

CONFIG_ESPTOOLPY_FLASHSIZE_4MB=y
CONFIG_ESPTOOLPY_FLASHSIZE="4MB"

CONFIG_FREERTOS_HZ=1000

# Common ESP-related
#
CONFIG_ESP_SYSTEM_EVENT_TASK_STACK_SIZE=4096
CONFIG_ESP_MAIN_TASK_STACK_SIZE=32768

# SPIRAM Configuration
CONFIG_SPIRAM=y
CONFIG_SPIRAM_USE_MALLOC=y
CONFIG_SPIRAM_MODE_OCT=y
CONFIG_SPIRAM_SPEED_80M=y
# CONFIG_SPIRAM_ALLOW_BSS_SEG_EXTERNAL_MEMORY=y

#
# Partition Table
#
CONFIG_PARTITION_TABLE_CUSTOM=y
CONFIG_PARTITION_TABLE_CUSTOM_FILENAME="partitions.csv"


# ESP32-specific
#
CONFIG_ESP_DEFAULT_CPU_FREQ_MHZ_240=y
CONFIG_ESP_DEFAULT_CPU_FREQ_MHZ=240

# ESP32-Camera specific
# CONFIG_SCCB_HARDWARE_I2C_DRIVER_LEGACY=y

# CONFIG_LWIP_IRAM_OPTIMIZATION=y
CONFIG_LWIP_TCPIP_TASK_PRIO=23

#
# ESP32S3-specific
#
CONFIG_ESP_WIFI_STATIC_RX_BUFFER_NUM=8
CONFIG_ESP_WIFI_DYNAMIC_RX_BUFFER_NUM=16
CONFIG_ESP_WIFI_STATIC_TX_BUFFER=y
CONFIG_ESP_WIFI_STATIC_TX_BUFFER_NUM=16
CONFIG_ESP_WIFI_AMPDU_TX_ENABLED=y

CONFIG_LWIP_TCP_SND_BUF_DEFAULT=16384
CONFIG_LWIP_TCP_WND_DEFAULT=16384
CONFIG_LWIP_TCP_RECVMBOX_SIZE=16
CONFIG_LWIP_UDP_RECVMBOX_SIZE=16
CONFIG_LWIP_TCPIP_RECVMBOX_SIZE=16
```

## components/expressive_eyes/example/main/Kconfig.projbuild
```kconfig
menu "Expressive Eyes Example Configuration"

    choice EXPRESSIVE_EYES_BOARD
        prompt "Select Board"
        default EXPRESSIVE_EYES_BOARD_ESP_BOX
        help
            Select the hardware board to run the example on.

        config EXPRESSIVE_EYES_BOARD_ESP_BOX
            bool "ESP-BOX"
            help
                Use ESP32-S3-BOX or ESP32-S3-BOX-3 development board.

        config EXPRESSIVE_EYES_BOARD_MATOUCH_ROTARY
            bool "MaTouch Rotary Display"
            help
                Use MaTouch Rotary Display board.

        config EXPRESSIVE_EYES_BOARD_WS_S3_TOUCH
            bool "WS-S3-Touch BSP"
            help
                Use WS-S3-Touch development board.

    endchoice

    choice EXPRESSIVE_EYES_DRAWING_METHOD
        prompt "Select Drawing Method"
        default EXPRESSIVE_EYES_MONOCHROME_BLUE if EXPRESSIVE_EYES_BOARD_WS_S3_TOUCH
        default EXPRESSIVE_EYES_FULL_FEATURED
        help
            Select the eye drawing implementation to use.

        config EXPRESSIVE_EYES_FULL_FEATURED
            bool "Full Featured (White eyes with black pupils)"
            help
                Draw realistic eyes with white background, black pupils, eyebrows, and cheeks.

        config EXPRESSIVE_EYES_MONOCHROME_BLUE
            bool "Monochrome Blue (Electric blue on black)"
            help
                Draw simple monochrome eyes in electric blue on black background without pupils.

    endchoice

endmenu
```

## components/expressive_eyes/example/sdkconfig.defaults
```kconfig
# ESP32-specific
CONFIG_IDF_TARGET="esp32s3"
CONFIG_ESP32S3_DEFAULT_CPU_FREQ_240=y

# Common ESP-related
#
CONFIG_ESP_SYSTEM_EVENT_TASK_STACK_SIZE=4096
CONFIG_ESP_MAIN_TASK_STACK_SIZE=8192

# Flash size
CONFIG_ESPTOOLPY_FLASHSIZE_4MB=y
CONFIG_ESPTOOLPY_FLASHSIZE="4MB"

# FreeRTOS
CONFIG_FREERTOS_HZ=1000

# PSRAM
CONFIG_SPIRAM=y
CONFIG_SPIRAM_MODE_OCT=y
CONFIG_SPIRAM_SPEED_80M=y

# Default board selection
CONFIG_EXPRESSIVE_EYES_BOARD_ESP_BOX=y
```
