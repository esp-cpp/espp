## components/timer/example/sdkconfig.defaults
```kconfig
# Common ESP-related
#
CONFIG_ESP_SYSTEM_EVENT_TASK_STACK_SIZE=4096
CONFIG_ESP_MAIN_TASK_STACK_SIZE=8192

# Enable support for power management
# NOTE: if you enable this the USB serial will not work in light sleep mode
# CONFIG_PM_ENABLE=y
# auto configure dynamic frequency scaling on boot (using default freq as max)
# CONFIG_PM_DFS_INIT_AUTO=y
# Enable tickless idle mode (NOTE: this is required for PM_ENABLE)
# CONFIG_FREERTOS_USE_TICKLESS_IDLE=y
```

## components/wifi/example/main/Kconfig.projbuild
```kconfig
menu "WiFi Example Configuration"

    config ESP_WIFI_SSID
        string "WiFi SSID"
        default "myssid"
        help
            SSID (network name) for the example to connect to.

    config ESP_WIFI_PASSWORD
        string "WiFi Password"
        default "mypassword"
        help
            WiFi password (WPA or WPA2) for the example to use.

    config ESP_MAXIMUM_RETRY
        int "Maximum retry"
        default 5
        help
            Set the Maximum retry to avoid station reconnecting to the AP unlimited when the AP is really inexistent.

    config TEST_WIFI_SCAN
        bool "Test WiFi scanning"
        default y
        help
            Enable WiFi scanning tests in the example.

    config TEST_SCAN_BEFORE_STA
        bool "Test scan before STA connection"
        default y
        depends on TEST_WIFI_SCAN
        help
            Test scanning before attempting STA connection.

    config TEST_SCAN_WITH_NO_CONFIG
        bool "Test scan with no WiFi config"
        default y
        depends on TEST_WIFI_SCAN
        help
            Test scanning when WiFi is not configured (no STA or AP active).

endmenu
```

## components/ws-s3-geek/Kconfig
```kconfig
menu "Waveshare S3 Geek Configuration"
    config WS_S3_GEEK_INTERRUPT_STACK_SIZE
        int "Interrupt stack size"
        default 4096
        help
            Size of the stack used for the interrupt handler. Used by the
            button callback.
endmenu
```

## components/ws-s3-lcd-1-47/Kconfig
```kconfig
menu "Waveshare S3 LCD 1.47 Configuration"
    config WS_S3_LCD_1_47_INTERRUPT_STACK_SIZE
        int "Interrupt stack size"
        default 4096
        help
            Size of the stack used for the interrupt handler. Used by the
            button callback.

    config WS_S3_LCD_1_47_INTERRUPT_PRIORITY
        int "Interrupt task priority"
        default 0
        range 0 25
        help
            FreeRTOS priority of the GPIO interrupt handler task (0 = lowest). Raise it
            if interrupt callbacks must run promptly relative to other tasks.

    config WS_S3_LCD_1_47_INTERRUPT_CORE_ID
        int "Interrupt task core ID"
        default -1
        range -1 1
        help
            Core to pin the GPIO interrupt handler task to (-1 = not pinned to any core).
endmenu
```

## components/ws-s3-touch/Kconfig
```kconfig
menu "Waveshare ESP32-S3 TouchLCD Configuration"
  choice WS_S3_TOUCH_VERSION
  prompt "TouchLCD Version"
  default WS_S3_TOUCH_VERSION_NEW
  help
    Select the version of the Waveshare ESP32-S3 TouchLCD you are using.
    This will determine which pins the driver configures.

  config WS_S3_TOUCH_VERSION_NEW
  bool "New Version"
  help
    The new version of the Waveshare ESP32-S3 TouchLCD uses different pins
    for the touch controller.

  config WS_S3_TOUCH_VERSION_OLD
  bool "Old Version"
  help
    The old version of the Waveshare ESP32-S3 TouchLCD uses different pins
    for the touch controller.
  endchoice

  config WS_S3_TOUCH_INTERRUPT_STACK_SIZE
  int "Interrupt stack size"
  default 4096
  help
    Size of the stack used for the interrupt handler. Used by the touch
    callback.

  config WS_S3_TOUCH_INTERRUPT_PRIORITY
  int "Interrupt task priority"
  default 0
  range 0 25
  help
    FreeRTOS priority of the GPIO interrupt handler task (0 = lowest). Raise it
    if interrupt callbacks must run promptly relative to other tasks.

  config WS_S3_TOUCH_INTERRUPT_CORE_ID
  int "Interrupt task core ID"
  default -1
  range -1 1
  help
    Core to pin the GPIO interrupt handler task to (-1 = not pinned to any core).
endmenu
```

## components/xiao-esp32s3-sense/example/main/Kconfig.projbuild
```kconfig
menu "Camera Streamer Configuration"

    config RTSP_SERVER_PORT
        int "RTSP Server Port"
        default 8554
        help
            The port number of the RTSP server.

    config RTSP_ACCEPT_TASK_STACK_SIZE
        int "RTSP accept task stack size (bytes)"
        range 2048 32768
        default 4096
        help
            Stack size for the RTSP server accept task.

    config RTSP_SESSION_TASK_STACK_SIZE
        int "RTSP session task stack size (bytes)"
        range 2048 32768
        default 4096
        help
            Stack size for the RTSP server session-dispatch task.

    config RTSP_CONTROL_TASK_STACK_SIZE
        int "RTSP control task stack size (bytes)"
        range 2048 32768
        default 8192
        help
            Stack size for each per-client RTSP control task. Increase this if
            the board reports a stack overflow in a task named like
            "RtspSession <id>".

    config ESP_WIFI_SSID
        string "WiFi SSID"
        default ""
        help
            SSID (network name) for the camera streamer to connect to.

    config ESP_WIFI_PASSWORD
        string "WiFi Password"
        default ""
        help
            WiFi password (WPA or WPA2) for the camera streamer to use.

    config ESP_MAXIMUM_RETRY
        int "Maximum retry"
        default 5
        help
            Set the Maximum retry to avoid station reconnecting to the AP unlimited when the AP is
            really inexistent.

endmenu
```

## components/xiao-esp32s3-sense/example/sdkconfig.defaults
```kconfig
CONFIG_IDF_TARGET="esp32s3"

CONFIG_FREERTOS_HZ=1000

# on the ESP32S3, which has native USB, we need to set the console so that the
# CLI can be configured correctly:
CONFIG_ESP_CONSOLE_USB_SERIAL_JTAG=y

# set compiler optimization level to -O2 (compile for performance)
CONFIG_COMPILER_OPTIMIZATION_PERF=y

CONFIG_ESPTOOLPY_FLASHSIZE_8MB=y
CONFIG_ESPTOOLPY_FLASHSIZE="8MB"
CONFIG_ESPTOOLPY_FLASHMODE_QIO=y

# Common ESP-related
#
CONFIG_ESP_SYSTEM_EVENT_TASK_STACK_SIZE=4096
CONFIG_ESP_MAIN_TASK_STACK_SIZE=32768

# Set esp-timer task stack size to 6KB
CONFIG_ESP_TIMER_TASK_STACK_SIZE=6144

# PSRAM configuration
CONFIG_SPIRAM=y
CONFIG_SPIRAM_USE_MALLOC=y
CONFIG_SPIRAM_MODE_OCT=y
CONFIG_SPIRAM_SPEED_80M=y

# Partition Table
CONFIG_PARTITION_TABLE_CUSTOM=y
CONFIG_PARTITION_TABLE_CUSTOM_FILENAME="partitions.csv"

# ESP32-S3 specific tuning for camera + RTSP workloads
CONFIG_ESP_DEFAULT_CPU_FREQ_MHZ_240=y
CONFIG_ESP_DEFAULT_CPU_FREQ_MHZ=240
CONFIG_LWIP_TCPIP_TASK_PRIO=23
CONFIG_ESP_WIFI_STATIC_RX_BUFFER_NUM=8
CONFIG_ESP_WIFI_DYNAMIC_RX_BUFFER_NUM=16
CONFIG_ESP_WIFI_STATIC_TX_BUFFER=y
CONFIG_ESP_WIFI_STATIC_TX_BUFFER_NUM=16
CONFIG_ESP_WIFI_AMPDU_TX_ENABLED=y
CONFIG_LWIP_TCP_SND_BUF_DEFAULT=16384
CONFIG_LWIP_TCP_WND_DEFAULT=16384
CONFIG_LWIP_TCP_RECVMBOX_SIZE=16
CONFIG_LWIP_UDP_RECVMBOX_SIZE=16
CONFIG_LWIP_TCPIP_RECVMBOX_SIZE=16

# RTSP task stack sizing
CONFIG_RTSP_ACCEPT_TASK_STACK_SIZE=4096
CONFIG_RTSP_SESSION_TASK_STACK_SIZE=4096
CONFIG_RTSP_CONTROL_TASK_STACK_SIZE=8192
```
