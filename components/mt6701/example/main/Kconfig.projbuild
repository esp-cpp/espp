## components/mt6701/example/main/Kconfig.projbuild
```kconfig
menu "Example Configuration"

    choice EXAMPLE_HARDWARE
        prompt "Hardware"
        default EXAMPLE_HARDWARE_MOTORGO_MINI
        help
            Select the hardware to run this example on.

        config EXAMPLE_HARDWARE_QTPYPICO
            depends on IDF_TARGET_ESP32
            bool "Qt Py PICO"

        config EXAMPLE_HARDWARE_QTPYS3
            depends on IDF_TARGET_ESP32S3
            bool "Qt Py S3"

        config EXAMPLE_HARDWARE_MOTORGO_MINI
            depends on IDF_TARGET_ESP32S3
            bool "MotorGo Mini"

        config EXAMPLE_HARDWARE_CUSTOM
            bool "Custom"
    endchoice

    config EXAMPLE_RUN_I2C
        bool "Run I2C Example"
        default n if EXAMPLE_HARDWARE_MOTORGO_MINI
        default y if EXAMPLE_HARDWARE_QTPYPICO || EXAMPLE_HARDWARE_QTPYS3 || EXAMPLE_HARDWARE_CUSTOM
        help
            Run I2C example.

    config EXAMPLE_I2C_SCL_GPIO
        int "SCL GPIO Num"
        depends on EXAMPLE_RUN_I2C
        range 0 50
        default 19 if EXAMPLE_HARDWARE_QTPYPICO
        default 40 if EXAMPLE_HARDWARE_QTPYS3
        default 19 if EXAMPLE_HARDWARE_CUSTOM
        help
            GPIO number for I2C Master clock line.

    config EXAMPLE_I2C_SDA_GPIO
        int "SDA GPIO Num"
        depends on EXAMPLE_RUN_I2C
        range 0 50
        default 22 if EXAMPLE_HARDWARE_QTPYPICO
        default 41 if EXAMPLE_HARDWARE_QTPYS3
        default 22 if EXAMPLE_HARDWARE_CUSTOM
        help
            GPIO number for I2C Master data line.

    config EXAMPLE_RUN_SPI
        bool "Run SPI Example"
        default y
        help
            Run SPI example.

    config EXAMPLE_SPI_CLOCK_SPEED
        int "SPI Clock Speed"
        depends on EXAMPLE_RUN_SPI
        range 100000 15000000
        default 10000000
        help
            SPI clock speed in Hz.

    config EXAMPLE_SPI_MISO_GPIO
        int "SPI MISO GPIO Num"
        depends on EXAMPLE_RUN_SPI
        range 0 50
        default 12 if EXAMPLE_HARDWARE_QTPYPICO
        default 12 if EXAMPLE_HARDWARE_QTPYS3
        default 35 if EXAMPLE_HARDWARE_MOTORGO_MINI
        default 12 if EXAMPLE_HARDWARE_CUSTOM
        help
            GPIO number for SPI Master In Slave Out line.

    config EXAMPLE_SPI_SCLK_GPIO
        int "SPI SCLK GPIO Num"
        depends on EXAMPLE_RUN_SPI
        range 0 50
        default 10 if EXAMPLE_HARDWARE_QTPYPICO
        default 10 if EXAMPLE_HARDWARE_QTPYS3
        default 36 if EXAMPLE_HARDWARE_MOTORGO_MINI
        default 10 if EXAMPLE_HARDWARE_CUSTOM
        help
            GPIO number for SPI Master clock line.

    config EXAMPLE_SPI_CS_GPIO
        int "SPI CS GPIO Num"
        depends on EXAMPLE_RUN_SPI
        range 0 50
        default 5 if EXAMPLE_HARDWARE_QTPYPICO
        default 5 if EXAMPLE_HARDWARE_QTPYS3
        default 37 if EXAMPLE_HARDWARE_MOTORGO_MINI
        default 5 if EXAMPLE_HARDWARE_CUSTOM
        help
            GPIO number for SPI chip select line.

endmenu
```

## components/odrive_ascii/example/sdkconfig.defaults.esp32s3
```kconfig
# on the ESP32S3, which has native USB, we need to set the console so that the
# CLI can be configured correctly:
CONFIG_ESP_CONSOLE_USB_SERIAL_JTAG=y
```

## components/pca9535/example/main/Kconfig.projbuild
```kconfig
menu "Example Configuration"

    choice EXAMPLE_HARDWARE
        prompt "Hardware"
        default EXAMPLE_HARDWARE_QTPYS3
        help
            Select the hardware to run this example on.

        config EXAMPLE_HARDWARE_QTPYPICO
            depends on IDF_TARGET_ESP32
            bool "Qt Py PICO"

        config EXAMPLE_HARDWARE_QTPYS3
            depends on IDF_TARGET_ESP32S3
            bool "Qt Py S3"

        config EXAMPLE_HARDWARE_CUSTOM
            bool "Custom"
    endchoice

    config EXAMPLE_I2C_SCL_GPIO
        int "SCL GPIO Num"
        range 0 50
        default 19 if EXAMPLE_HARDWARE_QTPYPICO
        default 40 if EXAMPLE_HARDWARE_QTPYS3
        default 19 if EXAMPLE_HARDWARE_CUSTOM
        help
            GPIO number for I2C Master clock line.

    config EXAMPLE_I2C_SDA_GPIO
        int "SDA GPIO Num"
        range 0 50
        default 22 if EXAMPLE_HARDWARE_QTPYPICO
        default 41 if EXAMPLE_HARDWARE_QTPYS3
        default 22 if EXAMPLE_HARDWARE_CUSTOM
        help
            GPIO number for I2C Master data line.

endmenu
```

## components/pcf85063/example/sdkconfig.defaults
```kconfig
CONFIG_IDF_TARGET="esp32s3"

# set the functions into IRAM
CONFIG_SPI_MASTER_IN_IRAM=y 
```

## components/pi4ioe5v/example/main/Kconfig.projbuild
```kconfig
menu "PI4IOE5V Example Configuration"

config EXAMPLE_I2C_SDA_GPIO
  int "I2C SDA GPIO"
  range 0 50
  default 21

config EXAMPLE_I2C_SCL_GPIO
  int "I2C SCL GPIO"
  range 0 50
  default 22

endmenu
```

## components/provisioning/example/main/Kconfig.projbuild
```kconfig
menu "WiFi Provisioning Example Configuration"

    config PROVISIONING_AP_SSID
        string "Access Point SSID"
        default "ESP32-Setup"
        help
            SSID (network name) for the temporary access point created for provisioning.
            Leave empty to auto-generate based on MAC address.

    config PROVISIONING_AP_PASSWORD
        string "Access Point Password"
        default "configure"
        help
            Password for the temporary access point.
            Must be at least 8 characters. Leave empty for open network.

    config PROVISIONING_AP_CHANNEL
        int "Access Point Channel"
        default 1
        range 1 13
        help
            WiFi channel for the access point (1-13).

    config PROVISIONING_AP_MAX_CONNECTIONS
        int "Max Simultaneous Connections"
        default 4
        range 1 10
        help
            Maximum number of stations that can connect to the AP simultaneously.

    config PROVISIONING_SERVER_PORT
        int "Web Server Port"
        default 80
        range 1 65535
        help
            HTTP port for the provisioning web server.

    config PROVISIONING_TIMEOUT_SECONDS
        int "Provisioning Timeout (seconds)"
        default 300
        range 0 3600
        help
            Time in seconds before provisioning times out.
            Set to 0 for no timeout.

    config PROVISIONING_AUTO_GENERATE_SSID
        bool "Auto-generate unique SSID"
        default n
        help
            If enabled, appends the last 3 bytes of MAC address to the AP SSID
            to make it unique (e.g., "ESP32-Setup-AB12CD").

    config PROVISIONING_RESET_BUTTON_GPIO
        int "Reset Button GPIO"
        default -1
        range -1 48
        help
            GPIO pin for reset button to clear stored credentials.
            Set to -1 to disable reset button feature.

    config PROVISIONING_LED_GPIO
        int "Status LED GPIO"
        default -1
        range -1 48
        help
            GPIO pin for status LED (blinks during provisioning).
            Set to -1 to disable LED feature.

    config PROVISIONING_VALIDATE_CREDENTIALS
        bool "Validate WiFi credentials before saving"
        default y
        help
            Test WiFi connection before saving credentials to NVS.
            Recommended to prevent saving invalid credentials.

    config PROVISIONING_NVS_NAMESPACE
        string "NVS Namespace"
        default "wifi_config"
        help
            NVS namespace to store WiFi credentials.

endmenu
```

## components/provisioning/example/sdkconfig.defaults
```kconfig
# Flash size
CONFIG_ESPTOOLPY_FLASHSIZE_4MB=y
CONFIG_ESPTOOLPY_FLASHSIZE="4MB"

# CONFIG_ESP32_WIFI_NVS_ENABLED=n

CONFIG_PARTITION_TABLE_CUSTOM=y
CONFIG_PARTITION_TABLE_CUSTOM_FILENAME="partitions.csv"
CONFIG_PARTITION_TABLE_FILENAME="partitions.csv"
CONFIG_PARTITION_TABLE_OFFSET=0x8000
CONFIG_PARTITION_TABLE_MD5=y

# Common ESP-related
#
CONFIG_ESP_SYSTEM_EVENT_TASK_STACK_SIZE=4096
CONFIG_ESP_MAIN_TASK_STACK_SIZE=8192

# HTTP Server
CONFIG_HTTPD_MAX_REQ_HDR_LEN=1024
CONFIG_HTTPD_MAX_URI_LEN=512
```

## components/qtpy/Kconfig
```kconfig
menu "QtPy Configuration"
    config QTPY_INTERRUPT_STACK_SIZE
        int "Interrupt stack size"
        default 4096
        help
            Size of the stack used for the interrupt handler. Used by the
            button callback.
endmenu
```

## components/remote_debug/example/main/Kconfig.projbuild
```kconfig
menu "Remote Debug Example Configuration"

    config REMOTE_DEBUG_DEVICE_NAME
        string "Device Name"
        default "ESP32 Device"
        help
            Name of the device shown in the web interface title.

    config REMOTE_DEBUG_WIFI_SSID
        string "WiFi SSID"
        default ""
        help
            SSID (network name) for the example to connect to. If left blank, it will connect to the last used SSID.

    config REMOTE_DEBUG_WIFI_PASSWORD
        string "WiFi Password"
        default ""
        help
            WiFi password (WPA or WPA2) for the example to use.

    config REMOTE_DEBUG_SERVER_PORT
        int "Debug Server Port"
        default 8080
        range 1 65535
        help
            HTTP port for the remote debug web interface.

    menu "GPIO Configuration"

        config REMOTE_DEBUG_NUM_GPIOS
            int "Number of GPIOs to expose"
            default 4
            range 1 10
            help
                Number of GPIO pins to make available for remote control.

        config REMOTE_DEBUG_GPIO_0
            int "GPIO Pin 0"
            default 2
            range 0 48
            depends on REMOTE_DEBUG_NUM_GPIOS >= 1
            help
                First GPIO pin to control.

        config REMOTE_DEBUG_GPIO_0_LABEL
            string "GPIO Pin 0 Label"
            default "GPIO 2"
            depends on REMOTE_DEBUG_NUM_GPIOS >= 1
            help
                Label for first GPIO pin.

        config REMOTE_DEBUG_GPIO_1
            int "GPIO Pin 1"
            default 4
            range 0 48
            depends on REMOTE_DEBUG_NUM_GPIOS >= 2
            help
                Second GPIO pin to control.

        config REMOTE_DEBUG_GPIO_1_LABEL
            string "GPIO Pin 1 Label"
            default "GPIO 4"
            depends on REMOTE_DEBUG_NUM_GPIOS >= 2
            help
                Label for second GPIO pin.

        config REMOTE_DEBUG_GPIO_2
            int "GPIO Pin 2"
            default 16
            range 0 48
            depends on REMOTE_DEBUG_NUM_GPIOS >= 3
            help
                Third GPIO pin to control.

        config REMOTE_DEBUG_GPIO_2_LABEL
            string "GPIO Pin 2 Label"
            default "GPIO 16"
            depends on REMOTE_DEBUG_NUM_GPIOS >= 3
            help
                Label for third GPIO pin.

        config REMOTE_DEBUG_GPIO_3
            int "GPIO Pin 3"
            default 17
            range 0 48
            depends on REMOTE_DEBUG_NUM_GPIOS >= 4
            help
                Fourth GPIO pin to control.

        config REMOTE_DEBUG_GPIO_3_LABEL
            string "GPIO Pin 3 Label"
            default "GPIO 17"
            depends on REMOTE_DEBUG_NUM_GPIOS >= 4
            help
                Label for fourth GPIO pin.

        config REMOTE_DEBUG_GPIO_4
            int "GPIO Pin 4"
            default 18
            range 0 48
            depends on REMOTE_DEBUG_NUM_GPIOS >= 5
            help
                Fifth GPIO pin to control.

        config REMOTE_DEBUG_GPIO_5
            int "GPIO Pin 5"
            default 19
            range 0 48
            depends on REMOTE_DEBUG_NUM_GPIOS >= 6
            help
                Sixth GPIO pin to control.

        config REMOTE_DEBUG_GPIO_6
            int "GPIO Pin 6"
            default 21
            range 0 48
            depends on REMOTE_DEBUG_NUM_GPIOS >= 7
            help
                Seventh GPIO pin to control.

        config REMOTE_DEBUG_GPIO_7
            int "GPIO Pin 7"
            default 22
            range 0 48
            depends on REMOTE_DEBUG_NUM_GPIOS >= 8
            help
                Eighth GPIO pin to control.

        config REMOTE_DEBUG_GPIO_8
            int "GPIO Pin 8"
            default 23
            range 0 48
            depends on REMOTE_DEBUG_NUM_GPIOS >= 9
            help
                Ninth GPIO pin to control.

        config REMOTE_DEBUG_GPIO_9
            int "GPIO Pin 9"
            default 25
            range 0 48
            depends on REMOTE_DEBUG_NUM_GPIOS >= 10
            help
                Tenth GPIO pin to control.

    endmenu

    menu "ADC Configuration"

        config REMOTE_DEBUG_NUM_ADCS
            int "Number of ADC channels to monitor"
            default 2
            range 0 8
            help
                Number of ADC channels to monitor and plot.

        config REMOTE_DEBUG_ADC_0
            int "ADC Channel 0"
            default 36
            range 0 48
            depends on REMOTE_DEBUG_NUM_ADCS >= 1
            help
                First ADC pin to monitor (GPIO number).

        config REMOTE_DEBUG_ADC_0_LABEL
            string "ADC Channel 0 Label"
            default "ADC 36"
            depends on REMOTE_DEBUG_NUM_ADCS >= 1
            help
                Label for first ADC channel.

        config REMOTE_DEBUG_ADC_1
            int "ADC Channel 1"
            default 39
            range 0 48
            depends on REMOTE_DEBUG_NUM_ADCS >= 2
            help
                Second ADC pin to monitor (GPIO number).

        config REMOTE_DEBUG_ADC_1_LABEL
            string "ADC Channel 1 Label"
            default "ADC 39"
            depends on REMOTE_DEBUG_NUM_ADCS >= 2
            help
                Label for second ADC channel.

        config REMOTE_DEBUG_ADC_2
            int "ADC Channel 2"
            default 34
            range 0 48
            depends on REMOTE_DEBUG_NUM_ADCS >= 3
            help
                Third ADC pin to monitor (GPIO number).

        config REMOTE_DEBUG_ADC_3
            int "ADC Channel 3"
            default 35
            range 0 48
            depends on REMOTE_DEBUG_NUM_ADCS >= 4
            help
                Fourth ADC pin to monitor (GPIO number).

        config REMOTE_DEBUG_ADC_4
            int "ADC Channel 4"
            default 32
            range 0 48
            depends on REMOTE_DEBUG_NUM_ADCS >= 5
            help
                Fifth ADC pin to monitor (GPIO number).

        config REMOTE_DEBUG_ADC_5
            int "ADC Channel 5"
            default 33
            range 0 48
            depends on REMOTE_DEBUG_NUM_ADCS >= 6
            help
                Sixth ADC pin to monitor (GPIO number).

        config REMOTE_DEBUG_ADC_6
            int "ADC Channel 6"
            default 25
            range 0 48
            depends on REMOTE_DEBUG_NUM_ADCS >= 7
            help
                Seventh ADC pin to monitor (GPIO number).

        config REMOTE_DEBUG_ADC_7
            int "ADC Channel 7"
            default 26
            range 0 48
            depends on REMOTE_DEBUG_NUM_ADCS >= 8
            help
                Eighth ADC pin to monitor (GPIO number).

        config REMOTE_DEBUG_ADC_SAMPLE_RATE_HZ
            int "ADC Sample Rate (Hz)"
            default 100
            range 1 1000
            depends on REMOTE_DEBUG_NUM_ADCS > 0
            help
                How often to sample ADC values (samples per second).

        config REMOTE_DEBUG_ADC_BUFFER_SIZE
            int "ADC Buffer Size"
            default 500
            range 10 10000
            depends on REMOTE_DEBUG_NUM_ADCS > 0
            help
                Number of samples to keep in buffer for plotting.

    endmenu

endmenu
```
