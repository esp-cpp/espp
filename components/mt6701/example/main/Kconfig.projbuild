## components/remote_debug/example/sdkconfig.defaults
```kconfig
# ESP32-specific
CONFIG_IDF_TARGET="esp32s3"

# set cpu speed to 240MHz
CONFIG_ESP_DEFAULT_CPU_FREQ_MHZ_240=y
CONFIG_ESP_DEFAULT_CPU_FREQ_MHZ=240

# FreeRTOS tick rate to 1000Hz
CONFIG_FREERTOS_HZ=1000

# set the main task stack size to 8k
CONFIG_ESP_MAIN_TASK_STACK_SIZE=8192

# Flash size
CONFIG_ESPTOOLPY_FLASHSIZE_4MB=y
CONFIG_ESPTOOLPY_FLASHSIZE="4MB"

CONFIG_PARTITION_TABLE_CUSTOM=y
CONFIG_PARTITION_TABLE_CUSTOM_FILENAME="partitions.csv"
CONFIG_PARTITION_TABLE_FILENAME="partitions.csv"
CONFIG_PARTITION_TABLE_OFFSET=0x8000
CONFIG_PARTITION_TABLE_MD5=y

# littlefs settings
CONFIG_LITTLEFS_FLUSH_FILE_EVERY_WRITE=y
CONFIG_LITTLEFS_MMAP_PARTITION=y

# Default settings
CONFIG_REMOTE_DEBUG_DEVICE_NAME="Remote Debug Example"
CONFIG_REMOTE_DEBUG_NUM_GPIOS=2
CONFIG_REMOTE_DEBUG_GPIO_0=17
CONFIG_REMOTE_DEBUG_GPIO_0_LABEL="LED"
CONFIG_REMOTE_DEBUG_GPIO_1=18
CONFIG_REMOTE_DEBUG_GPIO_1_LABEL="Button"
CONFIG_REMOTE_DEBUG_NUM_ADCS=2
CONFIG_REMOTE_DEBUG_ADC_0=7
CONFIG_REMOTE_DEBUG_ADC_0_LABEL="Joy LX"
CONFIG_REMOTE_DEBUG_ADC_1=8
CONFIG_REMOTE_DEBUG_ADC_1_LABEL="Joy LY"
```

## components/rtsp/example/main/Kconfig.projbuild
```kconfig
menu "RTSP Example Configuration"

    config RTSP_SERVER_PORT
        int "RTSP Server Port"
        default 8554
        help
            The port number of the RTSP server.

    choice RTSP_EXAMPLE_MODE
        prompt "Example Mode"
        default RTSP_EXAMPLE_MODE_LEGACY
        help
            Select which RTSP example mode to run.

        config RTSP_EXAMPLE_MODE_LEGACY
            bool "Legacy MJPEG (server + client)"
            help
                Runs the original MJPEG server and client on the same device.
                The server streams a JPEG image and the client receives it.
                Uses the backward-compatible JpegFrame API.

        config RTSP_EXAMPLE_MODE_SERVER_ONLY
            bool "MJPEG Server only"
            help
                Runs only the RTSP server streaming MJPEG frames.
                Connect an external RTSP client (e.g. VLC) to view the stream.

        config RTSP_EXAMPLE_MODE_CLIENT_ONLY
            bool "MJPEG Client only"
            help
                Runs only the RTSP client connecting to a remote RTSP server.
                Requires an external RTSP server to be running.

        config RTSP_EXAMPLE_MODE_MULTITRACK
            bool "Multi-track server (MJPEG + audio)"
            help
                Runs a multi-track RTSP server with an MJPEG video track and
                a generic audio track, demonstrating the add_track() API
                and generic send_frame(track_id, data) API.

    endchoice

    config RTSP_EXAMPLE_RUN_API_TESTS
        bool "Run API tests at startup"
        default y
        help
            Run offline API tests for packetizers, depacketizers, and
            server/client construction before starting network operations.
            This exercises the component APIs to catch breaking changes.

    config RTSP_CLIENT_SERVER_ADDRESS
        string "Remote RTSP server address (client-only mode)"
        default "192.168.1.100"
        depends on RTSP_EXAMPLE_MODE_CLIENT_ONLY
        help
            IP address of the remote RTSP server to connect to in client-only mode.

    config ESP_WIFI_SSID
        string "WiFi SSID"
        default "myssid"
        help
            SSID (network name) for the example to connect to.

    config ESP_WIFI_PASSWORD
        string "WiFi Password"
        default "mypassword"
        help
            WiFi password (WPA or WPA2) for the example to use.

    config ESP_MAXIMUM_RETRY
        int "Maximum retry"
        default 5
        help
            Set the Maximum retry to avoid station reconnecting to the AP unlimited when the AP is really inexistent.

endmenu
```

## components/rtsp/example/sdkconfig.defaults
```kconfig
# Common ESP-related
#
CONFIG_ESP_SYSTEM_EVENT_TASK_STACK_SIZE=4096
CONFIG_ESP_MAIN_TASK_STACK_SIZE=8192

CONFIG_ESPTOOLPY_FLASHSIZE_8MB=y

#
# Partition Table
#
CONFIG_PARTITION_TABLE_CUSTOM=y
CONFIG_PARTITION_TABLE_CUSTOM_FILENAME="partitions.csv"
```

## components/rx8130ce/example/main/Kconfig.projbuild
```kconfig
menu "Example Configuration"

choice EXAMPLE_HARDWARE
  prompt "Hardware"
  default EXAMPLE_HARDWARE_CUSTOM
  help
    Select the hardware to run this example on.

config EXAMPLE_HARDWARE_CUSTOM
  bool "Custom"
endchoice

config EXAMPLE_I2C_SCL_GPIO
  int "SCL GPIO Num"
  range 0 50
  default 19
  help
    GPIO number for I2C Master clock line.

config EXAMPLE_I2C_SDA_GPIO
  int "SDA GPIO Num"
  range 0 50
  default 22
  help
    GPIO number for I2C Master data line.

config EXAMPLE_I2C_CLOCK_SPEED_HZ
  int "I2C Clock Speed"
  range 100 1000000
  default 400000
  help
    I2C clock speed in Hz.

endmenu
```

## components/seeed-studio-round-display/Kconfig
```kconfig
menu "Seeed Studio Round Display Configuration"
    config SEEED_STUDIO_ROUND_DISPLAY_INTERRUPT_STACK_SIZE
        int "Interrupt stack size"
        default 4096
        help
            Size of the stack used for the interrupt handler. Used by the touch
            callback.
endmenu
```

## components/seeed-studio-round-display/example/main/Kconfig.projbuild
```kconfig
menu "Seeed Studio Round Display Example Config"

    choice EXAMPLE_HARDWARE
        prompt "Hardware"
        default EXAMPLE_HARDWARE_XIAOS3
        help
            Select the hardware to run this example on.

        config EXAMPLE_HARDWARE_QTPYS3
            depends on IDF_TARGET_ESP32S3
            bool "Qt Py ESP32 S3"

        config EXAMPLE_HARDWARE_XIAOS3
            depends on IDF_TARGET_ESP32S3
            bool "XIAO Esp32 S3"
    endchoice

endmenu
```

## components/smartpanle-sc01-plus/example/sdkconfig.defaults
```kconfig
CONFIG_IDF_TARGET="esp32s3"

CONFIG_FREERTOS_HZ=1000
CONFIG_COMPILER_OPTIMIZATION_PERF=y

CONFIG_ESPTOOLPY_FLASHSIZE_8MB=y
CONFIG_ESPTOOLPY_FLASHSIZE="8MB"
CONFIG_ESPTOOLPY_FLASHMODE_QIO=y

CONFIG_ESP_SYSTEM_EVENT_TASK_STACK_SIZE=4096
CONFIG_ESP_MAIN_TASK_STACK_SIZE=12288
CONFIG_ESP_TIMER_TASK_STACK_SIZE=6144

CONFIG_PARTITION_TABLE_CUSTOM=y
CONFIG_PARTITION_TABLE_OFFSET=0x9000
CONFIG_PARTITION_TABLE_CUSTOM_FILENAME="partitions.csv"

CONFIG_SMARTPANLEE_SC01_PLUS_INTERRUPT_STACK_SIZE=4096

CONFIG_LV_DEF_REFR_PERIOD=16
CONFIG_LV_USE_THEME_DEFAULT=y
CONFIG_LV_THEME_DEFAULT_DARK=y
CONFIG_LV_THEME_DEFAULT_GROW=y
CONFIG_LV_THEME_DEFAULT_TRANSITION_TIME=30
```

## components/smartpanlee-sc01-plus/Kconfig
```kconfig
menu "Smart Panlee SC01 Plus Configuration"
  config SMARTPANLEE_SC01_PLUS_INTERRUPT_STACK_SIZE
  int "Interrupt stack size"
  default 4096
  help
    Size of the stack used for the touch interrupt handler task.

  config SMARTPANLEE_SC01_PLUS_INTERRUPT_PRIORITY
  int "Interrupt task priority"
  default 0
  range 0 25
  help
    FreeRTOS priority of the GPIO interrupt handler task (0 = lowest). Raise it
    if interrupt callbacks must run promptly relative to other tasks.

  config SMARTPANLEE_SC01_PLUS_INTERRUPT_CORE_ID
  int "Interrupt task core ID"
  default -1
  range -1 1
  help
    Core to pin the GPIO interrupt handler task to (-1 = not pinned to any core).

  config SMARTPANLEE_SC01_PLUS_AUDIO_TASK_STACK_SIZE
  int "Audio task stack size"
  default 4096
  help
    Size of the stack used for the background audio playback task.
endmenu
```

## components/snmp/example/main/Kconfig.projbuild
```kconfig
menu "SNMP Example Configuration"

    config SNMP_EXAMPLE_WIFI_SSID
        string "WiFi SSID"
        default ""
        help
            WiFi SSID for the example. Leave empty to use saved station credentials.

    config SNMP_EXAMPLE_WIFI_PASSWORD
        string "WiFi password"
        default ""
        help
            WiFi password for the example. Leave empty to use saved station credentials.

    config SNMP_EXAMPLE_TARGET_HOST
        string "SNMP target host"
        default "192.168.1.1"
        help
            IPv4 address or hostname of the target SNMP agent.

    config SNMP_EXAMPLE_COMMUNITY
        string "SNMP community"
        default "public"
        help
            Community string used when SNMPv2c mode is selected.

    config SNMP_EXAMPLE_USE_V3
        bool "Use SNMPv3 authPriv"
        default n
        help
            Enable SNMPv3 authPriv instead of SNMPv2c.

    config SNMP_EXAMPLE_V3_USERNAME
        string "SNMPv3 username"
        default "snmpuser"
        depends on SNMP_EXAMPLE_USE_V3

    config SNMP_EXAMPLE_V3_AUTH_PASSWORD
        string "SNMPv3 auth password"
        default "authpassword"
        depends on SNMP_EXAMPLE_USE_V3

    config SNMP_EXAMPLE_V3_PRIV_PASSWORD
        string "SNMPv3 privacy password"
        default "privpassword"
        depends on SNMP_EXAMPLE_USE_V3

    config SNMP_EXAMPLE_TIMEOUT_MS
        int "SNMP timeout (ms)"
        default 1500
        help
            Per-request timeout in milliseconds.

endmenu
```

## components/socket/example/sdkconfig.defaults
```kconfig
# CONFIG_ESP32_WIFI_NVS_ENABLED=n

CONFIG_PARTITION_TABLE_CUSTOM=y
CONFIG_PARTITION_TABLE_CUSTOM_FILENAME="partitions.csv"
CONFIG_PARTITION_TABLE_FILENAME="partitions.csv"
CONFIG_PARTITION_TABLE_OFFSET=0x8000
CONFIG_PARTITION_TABLE_MD5=y

# Common ESP-related
#
CONFIG_ESP_SYSTEM_EVENT_TASK_STACK_SIZE=4096
CONFIG_ESP_MAIN_TASK_STACK_SIZE=8192
```

## components/st25dv/example/main/Kconfig.projbuild
```kconfig
menu "NFC WiFi Configuration"

    config ESP_WIFI_SSID
        string "WiFi SSID"
        default "myssid"
        help
            SSID (network name) for the NFC to provide configuration for.

    config ESP_WIFI_PASSWORD
        string "WiFi Password"
        default "mypassword"
        help
            WiFi password (WPA or WPA2) for the NFC to provide configuration for.

endmenu
```

## components/st25dv/example/sdkconfig.defaults
```kconfig
CONFIG_IDF_TARGET="esp32s3"

CONFIG_FREERTOS_HZ=1000

# ESP32-specific
#
CONFIG_ESP_DEFAULT_CPU_FREQ_MHZ_240=y
CONFIG_ESP_DEFAULT_CPU_FREQ_MHZ=240

CONFIG_BT_ENABLED=y
CONFIG_BT_BLE_ENABLED=y

# Common ESP-related
#
CONFIG_ESP_SYSTEM_EVENT_TASK_STACK_SIZE=4096
CONFIG_ESP_MAIN_TASK_STACK_SIZE=8192

# SPI Flash Config:
CONFIG_ESPTOOLPY_FLASHSIZE_8MB=y

# Partition Table
CONFIG_PARTITION_TABLE_CUSTOM=y
CONFIG_PARTITION_TABLE_CUSTOM_FILENAME="partitions.csv"
```

## components/st7123touch/example/main/Kconfig.projbuild
```kconfig
menu "Example Configuration"

    config EXAMPLE_I2C_SCL_GPIO
        int "SCL GPIO Num"
        range 0 56
        default 22
        help
            GPIO number for I2C Master clock line.

    config EXAMPLE_I2C_SDA_GPIO
        int "SDA GPIO Num"
        range 0 56
        default 21
        help
            GPIO number for I2C Master data line.

endmenu
```

## components/t-deck/Kconfig
```kconfig
menu "T-Deck Configuration"
    config TDECK_INTERRUPT_STACK_SIZE
        int "Interrupt stack size"
        default 4096
        help
            Size of the stack used for the interrupt handler. Shared by the
            keyboard callback and the touch callback.
endmenu
```

## components/t-deck/example/sdkconfig.defaults
```kconfig
CONFIG_IDF_TARGET="esp32s3"

CONFIG_FREERTOS_HZ=1000

# set compiler optimization level to -O2 (compile for performance)
CONFIG_COMPILER_OPTIMIZATION_PERF=y

CONFIG_ESPTOOLPY_FLASHSIZE_16MB=y
CONFIG_ESPTOOLPY_FLASHSIZE="16MB"
CONFIG_ESPTOOLPY_FLASHMODE_QIO=y # over twice as fast as DIO

# ESP32-specific
#
CONFIG_ESP_DEFAULT_CPU_FREQ_MHZ_240=y
CONFIG_ESP_DEFAULT_CPU_FREQ_MHZ=240

# Common ESP-related
#
CONFIG_ESP_SYSTEM_EVENT_TASK_STACK_SIZE=4096
CONFIG_ESP_MAIN_TASK_STACK_SIZE=16384

# Set esp-timer task stack size to 6KB
CONFIG_ESP_TIMER_TASK_STACK_SIZE=6144

# set the functions into IRAM
CONFIG_SPI_MASTER_IN_IRAM=y

CONFIG_LV_DEF_REFR_PERIOD=16

#
# LVGL configuration - # Themes
#
CONFIG_LV_USE_THEME_DEFAULT=y
CONFIG_LV_THEME_DEFAULT_DARK=y
CONFIG_LV_THEME_DEFAULT_GROW=y
CONFIG_LV_THEME_DEFAULT_TRANSITION_TIME=80
```

## components/t-dongle-s3/Kconfig
```kconfig
menu "T-Dongle-S3 Configuration"
    config T_DONGLE_S3_INTERRUPT_STACK_SIZE
        int "Interrupt stack size"
        default 4096
        help
            Size of the stack used for the interrupt handler. Used by the
            button callback.
endmenu
```
