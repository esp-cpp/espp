## components/file_system/Kconfig.projbuild
```kconfig
menu "ESPP File System Configuration"

    config ESPP_FILE_SYSTEM_PARTITION_LABEL
        string "Partition Label"
        default "littlefs"
        help
            The partition label of the littlefs file system as configured in partitions.csv.

endmenu
```

## components/ft5x06/example/main/Kconfig.projbuild
```kconfig
menu "Example Configuration"

    choice EXAMPLE_HARDWARE
        prompt "Hardware"
        default EXAMPLE_HARDWARE_BOX
        help
            Select the hardware to run this example on.

        config EXAMPLE_HARDWARE_BOX
            depends on IDF_TARGET_ESP32S3
            bool "ESP32-S3 Box"

        config EXAMPLE_HARDWARE_CUSTOM
            bool "Custom"
    endchoice

    config EXAMPLE_I2C_SCL_GPIO
        int "SCL GPIO Num"
        range 0 50
        default 18 if EXAMPLE_HARDWARE_BOX
        default 19 if EXAMPLE_HARDWARE_CUSTOM
        help
            GPIO number for I2C Master clock line.

    config EXAMPLE_I2C_SDA_GPIO
        int "SDA GPIO Num"
        range 0 50
        default 8 if EXAMPLE_HARDWARE_BOX
        default 22 if EXAMPLE_HARDWARE_CUSTOM
        help
            GPIO number for I2C Master data line.

endmenu
```

## components/gfps_service/Kconfig.projbuild
```kconfig
menu "GFPS Configuration"
    config GFPS_MODEL_ID
        hex "GFPS Model ID"
        default 0x0
        help
            Set the model id (24 bit) used for Google Fast Pair Service (GFPS)

    config GFPS_ANTISPOOFING_PRIVATE_KEY
        string "GFPS Anti-Spoofing Private Key"
        default ""
        help
            Set the GFPS anti-spoofing private key, as a base64 uncompressed string.

    config GFPS_TRACE_LEVEL
        int "GFPS Trace Level"
        default 6
        range 1 6
        help
            Set the trace level for GFPS. 1 is VERBOSE, 2 is DEBUG, 3 is INFO, 4
            is WARNING, 5 is ERROR, 6 is OFF.

    config NEARBY_FP_APP_CONTROL_SUB_PAIR_FLOW
        bool "Enable app-level control of GFPS Subsequent Pairing flow"
        default n
        help
            If enabled, the application takes control of the Subsequent Pairing flow.
            The GFPS library will no longer automatically start NDA advertisement or 
            handle SubPairing connection behavior, allowing full application control.

endmenu
```

## components/gt911/example/main/Kconfig.projbuild
```kconfig
menu "Example Configuration"

    choice EXAMPLE_HARDWARE
        prompt "Hardware"
        default EXAMPLE_HARDWARE_TDECK
        help
            Select the hardware to run this example on.

        config EXAMPLE_HARDWARE_TDECK
            depends on IDF_TARGET_ESP32S3
            bool "LilyGO T-Deck"

        config EXAMPLE_HARDWARE_BOX_3
            depends on IDF_TARGET_ESP32S3
            bool "ESP32-S3 BOX-3"

        config EXAMPLE_HARDWARE_CUSTOM
            bool "Custom"
    endchoice

    config EXAMPLE_I2C_SCL_GPIO
        int "SCL GPIO Num"
        range 0 50
        default 8 if EXAMPLE_HARDWARE_TDECK
        default 18 if EXAMPLE_HARDWARE_BOX_3
        default 19 if EXAMPLE_HARDWARE_CUSTOM
        help
            GPIO number for I2C Master clock line.

    config EXAMPLE_I2C_SDA_GPIO
        int "SDA GPIO Num"
        range 0 50
        default 18 if EXAMPLE_HARDWARE_TDECK
        default 8 if EXAMPLE_HARDWARE_BOX_3
        default 22 if EXAMPLE_HARDWARE_CUSTOM
        help
            GPIO number for I2C Master data line.

endmenu
```

## components/hid-rp/example/sdkconfig.defaults
```kconfig
CONFIG_IDF_TARGET="esp32s3"

# on the ESP32S3, which has native USB, we need to set the console so that the
# CLI can be configured correctly:
CONFIG_ESP_CONSOLE_USB_SERIAL_JTAG=y

# Common ESP-related
#
CONFIG_ESP_SYSTEM_EVENT_TASK_STACK_SIZE=4096
CONFIG_ESP_MAIN_TASK_STACK_SIZE=8192

CONFIG_FREERTOS_HZ=1000

CONFIG_ESPTOOLPY_FLASHSIZE_4MB=y
```

## components/hid_service/example/main/Kconfig.projbuild
```kconfig
menu "HID Service Example Configuration"
  choice "Example Gamepad Emulation"
  default EXAMPLE_AS_XBOX
  prompt "Select the gamepad emulation type for the example application."
  help
    Select the type of gamepad emulation to be used in the HID service example application.
  config EXAMPLE_AS_XBOX
  bool "Xbox Controller Emulation"
  help
    Emulate an Xbox controller for the HID service example application.
  config EXAMPLE_AS_PLAYSTATION_DUALSHOCK4_BLE
  bool "PS4 (DualShock 4) Controller Emulation over BLE"
  help
    Emulate a PS4 DualShock 4 controller for the HID service example application.
  config EXAMPLE_AS_PLAYSTATION_DUALSENSE_BLE
  bool "PS5 (DualSense) Controller Emulation over BLE"
  help
    Emulate a PS5 controller for the HID service example application.
  config EXAMPLE_AS_SWITCH_PRO
  bool "Switch Pro Controller Emulation"
  help
    Emulate a Switch Pro controller for the HID service example application.
  endchoice
endmenu
```

## components/hid_service/example/sdkconfig.defaults
```kconfig
CONFIG_IDF_TARGET="esp32s3"

# on the ESP32S3, which has native USB, we need to set the console so that the
# CLI can be configured correctly:
CONFIG_ESP_CONSOLE_USB_SERIAL_JTAG=y

# Common ESP-related
#
CONFIG_ESP_SYSTEM_EVENT_TASK_STACK_SIZE=4096
CONFIG_ESP_MAIN_TASK_STACK_SIZE=8192

CONFIG_FREERTOS_HZ=1000

CONFIG_ESPTOOLPY_FLASHSIZE_4MB=y

# Partition Table
CONFIG_PARTITION_TABLE_CUSTOM=y
CONFIG_PARTITION_TABLE_CUSTOM_FILENAME="partitions.csv"

#
# BT config
#
CONFIG_BT_ENABLED=y
CONFIG_BT_BLUEDROID_ENABLED=n
CONFIG_BT_NIMBLE_ENABLED=y
CONFIG_BT_NIMBLE_LOG_LEVEL_NONE=y
CONFIG_BT_NIMBLE_NVS_PERSIST=y
CONFIG_BT_NIMBLE_GAP_DEVICE_NAME_MAX_LEN=100
CONFIG_BT_NIMBLE_HOST_TASK_STACK_SIZE=8192

# NOTE: we can support extended advertising (longer advertisement packets) by
#       enabling the following:
# CONFIG_BT_NIMBLE_EXT_ADV=y
#
#   HOWEVER: we don't currently support this as the API to ble_gatt_server will
#            need to support this compile-time definition.

# Set the default Tx power level (P9 = +9dBm = the default)
# CONFIG_BT_CTRL_DFT_TX_POWER_LEVEL_P9=y

# Support modem sleep (low power mode)
# CONFIG_BT_CTRL_MODEM_SLEEP=y

# Set the ESP-NIMBLE-CPP Config
CONFIG_NIMBLE_CPP_LOG_LEVEL_NONE=y
```

## components/home_assistant/example/main/Kconfig.projbuild
```kconfig
menu "Home Assistant Example Configuration"

    config HOME_ASSISTANT_EXAMPLE_WIFI_SSID
        string "WiFi SSID"
        default ""
        help
            WiFi SSID for the example. Leave empty to use saved station credentials.

    config HOME_ASSISTANT_EXAMPLE_WIFI_PASSWORD
        string "WiFi password"
        default ""
        help
            WiFi password for the example. Leave empty to use saved station credentials.

    config HOME_ASSISTANT_EXAMPLE_MQTT_BROKER_URI
        string "MQTT broker URI"
        default ""
        help
            MQTT broker URI such as mqtt://192.168.1.10.

    config HOME_ASSISTANT_EXAMPLE_MQTT_USERNAME
        string "MQTT username"
        default ""

    config HOME_ASSISTANT_EXAMPLE_MQTT_PASSWORD
        string "MQTT password"
        default ""

    config HOME_ASSISTANT_EXAMPLE_DISCOVERY_PREFIX
        string "MQTT discovery prefix"
        default "homeassistant"

    config HOME_ASSISTANT_EXAMPLE_NODE_ID
        string "MQTT node id"
        default ""

    config HOME_ASSISTANT_EXAMPLE_DEVICE_NAME
        string "Device name"
        default "ESPP Home Assistant Example"

    config HOME_ASSISTANT_EXAMPLE_DEVICE_IDENTIFIER
        string "Device identifier"
        default "espp-home-assistant-example"

    config HOME_ASSISTANT_EXAMPLE_HOME_ASSISTANT_URL
        string "Home Assistant base URL"
        default ""
        help
            Base URL such as http://homeassistant.local:8123.

    config HOME_ASSISTANT_EXAMPLE_HOME_ASSISTANT_TOKEN
        string "Home Assistant access token"
        default ""
        help
            Long-lived access token for REST and WebSocket APIs.

    config HOME_ASSISTANT_EXAMPLE_ENABLE_WEBSOCKET
        bool "Enable Home Assistant WebSocket demo"
        default n

    config HOME_ASSISTANT_EXAMPLE_REST_TIMEOUT_MS
        int "REST / WebSocket timeout (ms)"
        default 10000

endmenu
```

## components/i2c/Kconfig
```kconfig
menu "ESPP I2C Component Configuration"

choice
    prompt "I2C API Selection"
    default ESPP_I2C_USE_NEW_API

config ESPP_I2C_USE_LEGACY_API
    bool "Use legacy I2C API (i2c.hpp)"
    help
      Use the deprecated ESP-IDF legacy I2C driver through i2c.hpp.
      This is only intended for older environments that still require the
      legacy driver.

config ESPP_I2C_USE_NEW_API
    bool "Use new I2C API (i2c.hpp, i2c_master.hpp, i2c_slave.hpp)"
    help
      Use the ESP-IDF master/slave bus APIs. In this mode, i2c.hpp keeps the
      familiar address-based espp::I2c helpers for compatibility while also
      exposing explicit device handles via add_device().

      This API is available on ESP-IDF >= 5.4.0 and is required for ESP-IDF
      6.0 and later.

endchoice

if ESPP_I2C_USE_LEGACY_API
config ESPP_I2C_LEGACY_API_DISABLE_DEPRECATION_WARNINGS
    bool "Disable deprecation warnings for legacy I2C API"
    default n
    help
      Disable deprecation warnings for the legacy I2C API (i2c.hpp).
      This is useful if you are using the legacy API and do not want to see warnings about its deprecation.
      Note that this may hide important warnings about future compatibility.

endif

endmenu
```

## components/i2c/example/main/Kconfig.projbuild
```kconfig
menu "Example Configuration"

choice EXAMPLE_HARDWARE
  prompt "Hardware"
  default EXAMPLE_HARDWARE_QTPYPICO
  help
    Select the hardware to run this example on.

config EXAMPLE_HARDWARE_QTPYPICO
  depends on IDF_TARGET_ESP32
  bool "Qt Py PICO"

config EXAMPLE_HARDWARE_QTPYS3
  depends on IDF_TARGET_ESP32S3
  bool "Qt Py S3"

config EXAMPLE_HARDWARE_CUSTOM
  bool "Custom"
endchoice

config EXAMPLE_I2C_SCL_GPIO
  int "SCL GPIO Num"
  range 0 50
  default 19 if EXAMPLE_HARDWARE_QTPYPICO
  default 40 if EXAMPLE_HARDWARE_QTPYS3
  default 19 if EXAMPLE_HARDWARE_CUSTOM
  help
    GPIO number for I2C Master clock line.

config EXAMPLE_I2C_SDA_GPIO
  int "SDA GPIO Num"
  range 0 50
  default 22 if EXAMPLE_HARDWARE_QTPYPICO
  default 41 if EXAMPLE_HARDWARE_QTPYS3
  default 22 if EXAMPLE_HARDWARE_CUSTOM
  help
    GPIO number for I2C Master data line.

config EXAMPLE_I2C_CLOCK_SPEED_HZ
  int "I2C Clock Speed"
  range 100 1000000
  default 400000
  help
      I2C clock speed in Hz.

config EXAMPLE_I2C_DEVICE_ADDR
  hex "I2C Device Address"
  range 0x00 0x7F
  default 0x3C
  help
      I2C device address of the device.

config EXAMPLE_I2C_DEVICE_REG_ADDR
  hex "I2C Device Register Address"
  range 0x00 0xFF
  default 0x00
  help
      I2C device register address of the device.

config EXAMPLE_I2C_DEVICE_REG_SIZE
  int "I2C Device Register Size"
  range 1 100
  default 1
  help
      I2C device register size of the device.

endmenu
```

## components/i2c/example/sdkconfig.defaults
```kconfig
# Common ESP-related
#
CONFIG_ESP_SYSTEM_EVENT_TASK_STACK_SIZE=4096
CONFIG_ESP_MAIN_TASK_STACK_SIZE=8192

# the cli library requires exceptions right now...
CONFIG_COMPILER_CXX_EXCEPTIONS=y
```

## components/i2c/example/sdkconfig.defaults.cli
```kconfig
# the cli library requires exceptions right now...
CONFIG_COMPILER_CXX_EXCEPTIONS=y
```

## components/icm20948/example/main/Kconfig.projbuild
```kconfig
menu "Example Configuration"

choice EXAMPLE_HARDWARE
  prompt "Hardware"
  default EXAMPLE_HARDWARE_QTPY
  help
    Select the hardware to run this example on.

  config EXAMPLE_HARDWARE_QTPY
    bool "QtPy ESP32 Pico or QtPy ESP32-S3"

  config EXAMPLE_HARDWARE_CUSTOM
    bool "Custom"
endchoice

config EXAMPLE_I2C_SCL_GPIO
  int "SCL GPIO Num"
  range 0 50
  default 40 if EXAMPLE_HARDWARE_QTPY && IDF_TARGET_ESP32S3
  default 19 if EXAMPLE_HARDWARE_QTPY && IDF_TARGET_ESP32
  default 19 if EXAMPLE_HARDWARE_CUSTOM
  help
    GPIO number for I2C Master clock line.

config EXAMPLE_I2C_SDA_GPIO
  int "SDA GPIO Num"
  range 0 50
  default 41 if EXAMPLE_HARDWARE_QTPY && IDF_TARGET_ESP32S3
  default 22 if EXAMPLE_HARDWARE_QTPY && IDF_TARGET_ESP32
  default 22 if EXAMPLE_HARDWARE_CUSTOM
  help
    GPIO number for I2C Master data line.

config EXAMPLE_I2C_CLOCK_SPEED_HZ
  int "I2C Clock Speed"
  range 100 1000000
  default 400000
  help
    I2C clock speed in Hz.

endmenu
```

## components/icm42607/example/main/Kconfig.projbuild
```kconfig
menu "Example Configuration"

    choice EXAMPLE_HARDWARE
        prompt "Hardware"
        default EXAMPLE_HARDWARE_ESP_BOX
        help
            Select the hardware to run this example on.

        config EXAMPLE_HARDWARE_ESP_BOX
            depends on IDF_TARGET_ESP32S3
            bool "ESP32-S3-BOX or ESP32-S3-BOX-3"

        config EXAMPLE_HARDWARE_CUSTOM
            bool "Custom"
    endchoice

    config EXAMPLE_I2C_SCL_GPIO
        int "SCL GPIO Num"
        range 0 50
        default 18 if EXAMPLE_HARDWARE_ESP_BOX
        default 19 if EXAMPLE_HARDWARE_CUSTOM
        help
            GPIO number for I2C Master clock line.

    config EXAMPLE_I2C_SDA_GPIO
        int "SDA GPIO Num"
        range 0 50
        default 8 if EXAMPLE_HARDWARE_ESP_BOX
        default 22 if EXAMPLE_HARDWARE_CUSTOM
        help
            GPIO number for I2C Master data line.

    config EXAMPLE_I2C_CLOCK_SPEED_HZ
        int "I2C Clock Speed"
        range 100 1000000
        default 400000
        help
            I2C clock speed in Hz.

endmenu
```

## components/ina226/example/main/Kconfig.projbuild
```kconfig
menu "INA226 Example Configuration"

config EXAMPLE_I2C_SDA_GPIO
  int "I2C SDA GPIO"
  range 0 50
  default 21
  default 31 if IDF_TARGET_ESP32P4

config EXAMPLE_I2C_SCL_GPIO
  int "I2C SCL GPIO"
  range 0 50
  default 22
  default 32 if IDF_TARGET_ESP32P4

config EXAMPLE_I2C_CLOCK_SPEED_HZ
  int "I2C Clock Speed"
  range 100 1000000
  default 1000000
  help
    I2C clock speed in Hz.

config EXAMPLE_USE_STATIC_ADDRESS
  bool "Use Static I2C Address"
  default n
  help
    If enabled, the example will use a static I2C address defined below.
    Otherwise, it will scan for the INA226 device on the I2C bus.

config EXAMPLE_I2C_ADDRESS
  hex "Static I2C Address"
  range 0x40 0x4F
  default 0x40
  depends on EXAMPLE_USE_STATIC_ADDRESS
  help
    Static I2C address of the INA226 device. Valid range is 0x40 to 0x4F.

endmenu
```

## components/iperf_menu/example/sdkconfig.defaults
```kconfig
# NOTE: because this uses iperf, we have to use a larger min flash size
CONFIG_ESPTOOLPY_FLASHSIZE_4MB=y

# CONFIG_ESP32_WIFI_NVS_ENABLED=n

CONFIG_PARTITION_TABLE_CUSTOM=y
CONFIG_PARTITION_TABLE_CUSTOM_FILENAME="partitions.csv"
CONFIG_PARTITION_TABLE_FILENAME="partitions.csv"
CONFIG_PARTITION_TABLE_OFFSET=0x8000
CONFIG_PARTITION_TABLE_MD5=y

# Common ESP-related
#
CONFIG_ESP_SYSTEM_EVENT_TASK_STACK_SIZE=4096
CONFIG_ESP_MAIN_TASK_STACK_SIZE=8192

# for the example:
CONFIG_FREERTOS_UNICORE=n
CONFIG_FREERTOS_HZ=1000

CONFIG_ESP_INT_WDT=n
CONFIG_ESP_TASK_WDT_EN=n

CONFIG_LWIP_ETHARP_TRUST_IP_MAC=n
CONFIG_LWIP_IRAM_OPTIMIZATION=y
CONFIG_LWIP_TCPIP_TASK_PRIO=23

CONFIG_IPERF_TRAFFIC_TASK_PRIORITY=23
CONFIG_IPERF_REPORT_TASK_PRIORITY=24
CONFIG_COMPILER_OPTIMIZATION_PERF=y
```
