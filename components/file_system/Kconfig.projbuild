## components/joystick/example/main/Kconfig.projbuild
```kconfig
menu "Example Configuration"

    choice EXAMPLE_HARDWARE
        prompt "Hardware"
        default EXAMPLE_HARDWARE_QTPYPICO
        help
            Select the hardware to run this example on.

        config EXAMPLE_HARDWARE_QTPYPICO
            depends on IDF_TARGET_ESP32
            bool "Qt Py PICO"

        config EXAMPLE_HARDWARE_QTPYS3
            depends on IDF_TARGET_ESP32S3
            bool "Qt Py S3"

        config EXAMPLE_HARDWARE_CUSTOM
            bool "Custom"
    endchoice

    config EXAMPLE_ADC_UNIT
        int "Example ADC Unit"
        default 2 if EXAMPLE_HARDWARE_QTPYPICO
        default 2 if EXAMPLE_HARDWARE_QTPYS3
        range 1 2
        help
            The ADC unit number for the sensor. The ESP32 has two ADC units,
            ADC_UNIT_1 and ADC_UNIT_2. Default is ADC UNIT 2.

    config EXAMPLE_ADC_CHANNEL_X
        int "Joystick X Axis ADC Channel"
        range 0 50
        default 9 if EXAMPLE_HARDWARE_QTPYPICO
        default 7 if EXAMPLE_HARDWARE_QTPYS3
        default 0 if EXAMPLE_HARDWARE_CUSTOM
        help
            ADC Channel for the X axis of the joystick. Default is ADC2 channel
            9 (A0) for Qt Py PICO and ADC2 channel 7 (A0) for Qt Py ESP32S3.

    config EXAMPLE_ADC_CHANNEL_Y
        int "Joystick Y Axis ADC Channel"
        range 0 50
        default 8 if EXAMPLE_HARDWARE_QTPYPICO
        default 6 if EXAMPLE_HARDWARE_QTPYS3
        default 1 if EXAMPLE_HARDWARE_CUSTOM
        help
            ADC Channel for the Y axis of the joystick. Default is ADC2 channel
            8 (A1) for Qt Py PICO and ADC2 channel 6 (A1) for Qt Py ESP32S3.

endmenu
```

## components/lsm6dso/Kconfig
```kconfig
menu "LSM6DSO Example Configuration"
    depends on ESPP_LSM6DSO_ENABLE

config EXAMPLE_LSM6DSO_I2C_PORT
    int "I2C port number"
    default 0
    help
        I2C port number to use for the LSM6DSO example.

config EXAMPLE_LSM6DSO_I2C_SDA_GPIO
    int "I2C SDA GPIO number"
    default 21
    help
        GPIO number for I2C SDA line for the LSM6DSO example.

config EXAMPLE_LSM6DSO_I2C_SCL_GPIO
    int "I2C SCL GPIO number"
    default 22
    help
        GPIO number for I2C SCL line for the LSM6DSO example.

config EXAMPLE_LSM6DSO_I2C_CLOCK_SPEED_HZ
    int "I2C clock speed (Hz)"
    default 400000
    help
        I2C clock speed in Hz for the LSM6DSO example.

endmenu
```

## components/matouch-rotary-display/Kconfig
```kconfig
menu "Matouch Rotary Display Configuration"
    config MATOUCH_INTERRUPT_STACK_SIZE
        int "Interrupt stack size"
        default 4096
        help
            Size of the stack used for the interrupt handler. Shared by the
            button callback and the touch callbacks.

    config MATOUCH_INTERRUPT_PRIORITY
        int "Interrupt task priority"
        default 0
        range 0 25
        help
            FreeRTOS priority of the GPIO interrupt handler task (0 = lowest). Raise it
            if interrupt callbacks must run promptly relative to other tasks.

    config MATOUCH_INTERRUPT_CORE_ID
        int "Interrupt task core ID"
        default -1
        range -1 1
        help
            Core to pin the GPIO interrupt handler task to (-1 = not pinned to any core).
endmenu
```

## components/monitor/example/sdkconfig.defaults
```kconfig
CONFIG_FREERTOS_USE_TRACE_FACILITY=y
CONFIG_FREERTOS_GENERATE_RUN_TIME_STATS=y

CONFIG_COMPILER_OPTIMIZATION_PERF=y
# CONFIG_COMPILER_OPTIMIZATION_SIZE=y

CONFIG_FREERTOS_HZ=1000

# ESP32-specific
#
CONFIG_ESP_DEFAULT_CPU_FREQ_MHZ_240=y
CONFIG_ESP_DEFAULT_CPU_FREQ_MHZ=240

# Common ESP-related
#
CONFIG_ESP_SYSTEM_EVENT_TASK_STACK_SIZE=4096
CONFIG_ESP_MAIN_TASK_STACK_SIZE=16384
```

## components/motorgo-axis/example/main/Kconfig.projbuild
```kconfig
menu "MotorGo Axis Example Configuration"
    config MOTORGO_AXIS_EXAMPLE_ENABLE_ENCODER_POLLING
        bool "Enable encoder polling"
        default n
        help
            Initialize the two encoder inputs and log their measured angles.
endmenu
```

## components/motorgo-mini/Kconfig
```kconfig
menu "MotorGo Mini Configuration"
    config MOTORGO_MINI_INTERRUPT_STACK_SIZE
        int "Interrupt stack size"
        default 4096
        help
            Size of the stack used for the interrupt handler. Used by the
            button callback.

    config MOTORGO_MINI_INTERRUPT_PRIORITY
        int "Interrupt task priority"
        default 0
        range 0 25
        help
            FreeRTOS priority of the GPIO interrupt handler task (0 = lowest). Raise it
            if interrupt callbacks must run promptly relative to other tasks.

    config MOTORGO_MINI_INTERRUPT_CORE_ID
        int "Interrupt task core ID"
        default -1
        range -1 1
        help
            Core to pin the GPIO interrupt handler task to (-1 = not pinned to any core).
endmenu
```

## components/motorgo-plink/example/main/Kconfig.projbuild
```kconfig
menu "MotorGo Plink Example Configuration"
    config MOTORGO_PLINK_EXAMPLE_ENABLE_ENCODER_POLLING
        bool "Enable encoder polling"
        default n
        help
            Initialize the four encoder inputs and log their measured angles.

    config MOTORGO_PLINK_EXAMPLE_ENABLE_MOTOR_SWEEP
        bool "Enable motor sweep demo"
        default n
        help
            Drive all four motors with a slow sinusoidal speed command. Keep
            this disabled unless the board is connected to a safe test setup.
endmenu
```
