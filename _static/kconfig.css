## components/adc/example/main/Kconfig.projbuild
```kconfig
menu "ADC Example Configuration"

    choice EXAMPLE_HARDWARE
        prompt "Hardware"
        default EXAMPLE_HARDWARE_QTPY_ESP32 if IDF_TARGET_ESP32
        default EXAMPLE_HARDWARE_QTPY_ESP32S3 if IDF_TARGET_ESP32S3
        default EXAMPLE_HARDWARE_M5STACK_TAB5 if IDF_TARGET_ESP32P4
        default EXAMPLE_HARDWARE_CUSTOM
        help
            Which hardware to run the example on. The board selections
            configure the ADC unit and channels to pins which are usable
            (exposed) on that board; select custom to choose the ADC unit and
            channels yourself.

        config EXAMPLE_HARDWARE_QTPY_ESP32
            depends on IDF_TARGET_ESP32
            bool "Adafruit QtPy ESP32 Pico"
            help
                Uses ADC unit 1, channels 4 and 5: the pins labeled 'TX'
                (GPIO32) and 'SCL' (GPIO33), the only ADC1-capable pins
                exposed on the board.

        config EXAMPLE_HARDWARE_QTPY_ESP32S3
            depends on IDF_TARGET_ESP32S3
            bool "Adafruit QtPy ESP32-S3"
            help
                Uses ADC unit 1, channels 7 and 8: the pins labeled 'A3'
                (GPIO8) and 'A2' (GPIO9).

        config EXAMPLE_HARDWARE_M5STACK_TAB5
            depends on IDF_TARGET_ESP32P4
            bool "M5Stack Tab5"
            help
                Uses ADC unit 1, channels 0 and 1: GPIO16 and GPIO17, which
                are exposed on the Tab5's expansion header.

                NOTE: the Grove connector's signal pins (GPIO53/54) are ADC
                unit 2 channels 4/5 and work with the oneshot ADC, but ADC2
                continuous (DMA) conversions on the ESP32-P4 currently
                produce all-zero samples with esp-idf, so this example uses
                ADC1 pins instead.

        config EXAMPLE_HARDWARE_CUSTOM
            bool "Custom"
            help
                Select the ADC unit and channels yourself.
    endchoice

    config EXAMPLE_ADC_UNIT
        int "ADC unit (1 or 2)" if EXAMPLE_HARDWARE_CUSTOM
        range 1 2
        default 1
        help
            The ADC unit both channels are read from.

            NOTE: the continuous (DMA) part of the example requires a
            DMA-capable unit; on ESP32, ESP32-C3, and ESP32-S3 that is only
            unit 1. On ESP32-P4, ADC2 continuous conversions currently
            produce all-zero samples with esp-idf, so prefer unit 1 there as
            well.

    config EXAMPLE_ADC_CHANNEL_1
        int "First ADC channel" if EXAMPLE_HARDWARE_CUSTOM
        range 0 9
        default 4 if EXAMPLE_HARDWARE_QTPY_ESP32
        default 7 if EXAMPLE_HARDWARE_QTPY_ESP32S3
        default 0 if EXAMPLE_HARDWARE_M5STACK_TAB5
        default 2
        help
            The first ADC channel to read. Which GPIO a channel maps to is
            chip specific; see the ADC section of your chip's technical
            reference manual (e.g. ADC1 channels 0-7 are GPIO 36-39/32-35 on
            ESP32, GPIO 1-10 on ESP32-S3, GPIO 16-23 on ESP32-P4).

    config EXAMPLE_ADC_CHANNEL_2
        int "Second ADC channel" if EXAMPLE_HARDWARE_CUSTOM
        range 0 9
        default 5 if EXAMPLE_HARDWARE_QTPY_ESP32
        default 8 if EXAMPLE_HARDWARE_QTPY_ESP32S3
        default 1 if EXAMPLE_HARDWARE_M5STACK_TAB5
        default 3
        help
            The second ADC channel to read. See EXAMPLE_ADC_CHANNEL_1 for the
            channel-to-GPIO mapping.

endmenu
```

## components/as5600/Kconfig
```kconfig
menu "AS5600 Configuration"
    config AS5600_MIN_DIFF
        int "Minimum difference for velocity calculation"
        default 2
        range 0 100
        help
          Set the minimum difference in encoder counts required to update
          the velocity calculation. If the absolute difference between the
          current and previous count is less than or equal to this value,
          the velocity will be set to 0. This helps filter out noise and
          small jitter in the encoder readings.

    config AS5600_USE_HIGH_RESOLUTION_TIMER
        bool "Use high resolution timer instead of software timer"
        default y
        help
          Drive the periodic encoder update with an esp_timer-backed
          HighResolutionTimer (microsecond resolution). This is the right
          choice for sub-millisecond update periods. Disable this to instead
          use an espp::Timer, which schedules against an absolute wake-up time
          (drift-free and in phase) but is limited to the FreeRTOS tick
          resolution.

endmenu
```

## components/audio/example/main/Kconfig.projbuild
```kconfig
menu "Example Configuration"

# The defaults are the LilyGo T-Deck's MAX98357A amplifier.

config EXAMPLE_I2S_BCLK_GPIO
  int "I2S BCLK GPIO"
  default 7
  help
    GPIO for the I2S bit clock.

config EXAMPLE_I2S_WS_GPIO
  int "I2S WS (LRCK) GPIO"
  default 5
  help
    GPIO for the I2S word select.

config EXAMPLE_I2S_DOUT_GPIO
  int "I2S data out GPIO"
  default 6
  help
    GPIO for the I2S data to the amplifier.

config EXAMPLE_POWER_ENABLE_GPIO
  int "Power enable GPIO (-1 for none)"
  default 10
  help
    GPIO driven high before the audio starts, for boards whose amplifier is
    on a switched rail (the T-Deck's peripheral power, GPIO10). -1 for none.

endmenu
```

## components/bno055/example/main/Kconfig.projbuild
```kconfig
menu "Example Configuration"

config EXAMPLE_I2C_SDA_GPIO
  int "SDA GPIO Num"
  range 0 50
  default 7 if IDF_TARGET_ESP32P4
  default 21
  help
    GPIO number for I2C Master data line.

config EXAMPLE_I2C_SCL_GPIO
  int "SCL GPIO Num"
  range 0 50
  default 8 if IDF_TARGET_ESP32P4
  default 22
  help
    GPIO number for I2C Master clock line.

config EXAMPLE_I2C_CLOCK_SPEED_HZ
  int "I2C Clock Speed"
  range 100 400000
  default 400000
  help
    I2C clock speed in Hz. The BNO055 supports up to 400 kHz.

config EXAMPLE_I2C_ADDRESS
  hex "BNO055 I2C Address"
  range 0x28 0x29
  default 0x28
  help
    I2C address of the BNO055: 0x28 with ADR (COM3) low, 0x29 with it high.

endmenu
```

## components/canopen/can_bridge_example/main/Kconfig.projbuild
```kconfig
menu "CAN Bridge Example Configuration"

    config CAN_BRIDGE_SIMULATED_NODE
        bool "Simulate a CANopen DS402 node instead of using the TWAI peripheral"
        default n
        help
            Run a simulated CANopen (CiA 301) node with a CiA 402 drive profile
            in firmware instead of bridging to the TWAI (CAN) peripheral, so the
            hosted CAN console and DS402 panel web apps can be exercised with no
            transceiver, bus, or drive attached. The node answers NMT, serves
            the default SDO channel (expedited + segmented, with CiA 301 abort
            codes) from an object dictionary that includes its own stored EDS
            (0x1021), runs the DS402 state machine with profile position /
            velocity / torque and homing modes, sends a heartbeat and a TPDO,
            and raises an EMCY when a fault is injected (write 1 to 0x2000).
            The USB side of the bridge is unchanged: the web apps connect and
            talk to it exactly as they would with real hardware.

    config CAN_BRIDGE_SIMULATED_NODE_ID
        int "Simulated node id"
        depends on CAN_BRIDGE_SIMULATED_NODE
        range 1 127
        default 1
        help
            The CANopen node id (1..127) the simulated node answers on: SDO on
            0x600/0x580 + id, heartbeat on 0x700 + id, TPDO1 on 0x180 + id.

endmenu
```

## components/desktop/example/main/Kconfig.projbuild
```kconfig
menu "Desktop Example Configuration"

    config DESKTOP_EXAMPLE_LOG_CAPTURE
        bool "Capture the console log for the Log Viewer app"
        default y
        help
            Install espp::ConsoleCapture first thing in app_main(): stdout /
            stderr are teed into a byte ring the Log Viewer app streams to the
            browser. The UART console keeps working. Disable to leave stdio
            untouched (the Log Viewer then only shows a hint).

    config DESKTOP_EXAMPLE_LOG_CAPTURE_BYTES
        int "Log capture ring size (bytes)"
        depends on DESKTOP_EXAMPLE_LOG_CAPTURE
        default 16384
        range 1024 262144
        help
            How many of the newest console bytes are kept for the Log Viewer
            (and shown when it opens).

    config DESKTOP_EXAMPLE_ENABLE_CANOPEN
        bool "CANopen / DS402 app"
        default y
        help
            Register the CANopen / DS402 app: an NMT master + SDO client
            (espp::CanopenClient) and a CiA 402 drive panel (espp::Ds402Drive)
            on the bus selected below.

    choice DESKTOP_EXAMPLE_CANOPEN_BUS
        prompt "CAN bus for the CANopen app"
        depends on DESKTOP_EXAMPLE_ENABLE_CANOPEN
        default DESKTOP_EXAMPLE_CANOPEN_BUS_SIMULATED
        help
            Where the CANopen app's frames go: an in-firmware simulated DS402
            node (no hardware needed; the CI default) or the TWAI peripheral
            wired to a CAN transceiver.

        config DESKTOP_EXAMPLE_CANOPEN_BUS_SIMULATED
            bool "Simulated DS402 node (no CAN hardware)"
        config DESKTOP_EXAMPLE_CANOPEN_BUS_TWAI
            bool "TWAI peripheral (CAN transceiver on the GPIOs below)"
    endchoice

    config DESKTOP_EXAMPLE_CANOPEN_NODE_ID
        int "CANopen node id"
        depends on DESKTOP_EXAMPLE_ENABLE_CANOPEN
        default 1
        range 1 127
        help
            The server node id the app talks to at launch (changeable in the
            window). With the simulated bus this is also the simulated node's id.

    config DESKTOP_EXAMPLE_CAN_TX_GPIO
        int "TWAI TX GPIO"
        depends on DESKTOP_EXAMPLE_CANOPEN_BUS_TWAI
        default 17

    config DESKTOP_EXAMPLE_CAN_RX_GPIO
        int "TWAI RX GPIO"
        depends on DESKTOP_EXAMPLE_CANOPEN_BUS_TWAI
        default 16

    config DESKTOP_EXAMPLE_CAN_BAUDRATE
        int "CAN bit rate (bit/s)"
        depends on DESKTOP_EXAMPLE_CANOPEN_BUS_TWAI
        default 500000
        range 10000 1000000

    config DESKTOP_EXAMPLE_ENABLE_I2C
        bool "I2C scanner app"
        default y
        help
            Register the I2C scanner app: probe every 7-bit address on the
            bus below, and read / write device registers.

    config DESKTOP_EXAMPLE_I2C_PORT
        int "I2C port"
        depends on DESKTOP_EXAMPLE_ENABLE_I2C
        default 0
        range 0 1

    config DESKTOP_EXAMPLE_I2C_SDA_GPIO
        int "I2C SDA GPIO"
        depends on DESKTOP_EXAMPLE_ENABLE_I2C
        default 8

    config DESKTOP_EXAMPLE_I2C_SCL_GPIO
        int "I2C SCL GPIO"
        depends on DESKTOP_EXAMPLE_ENABLE_I2C
        default 9

    config DESKTOP_EXAMPLE_I2C_FREQ_HZ
        int "I2C clock (Hz)"
        depends on DESKTOP_EXAMPLE_ENABLE_I2C
        default 400000
        range 1000 1000000

    config DESKTOP_EXAMPLE_ENABLE_WIFI
        bool "Network app: Wi-Fi station"
        depends on SOC_WIFI_SUPPORTED
        default y
        help
            Register the Network app's Wi-Fi group: status, scan, connect /
            disconnect with the credentials kept in NVS (espp::WifiSta).

    config DESKTOP_EXAMPLE_ENABLE_ETHERNET
        bool "Network app: Ethernet (RMII)"
        depends on SOC_EMAC_SUPPORTED
        default n
        help
            Register the Network app's Ethernet group: link / IP / MAC / speed
            of the internal EMAC over RMII (espp::Ethernet, ESP32-Ethernet-Kit
            pins in network_app.hpp).

endmenu
```

## components/esp32-ethernet-kit/example/main/Kconfig.projbuild
```kconfig
menu "ESP32-Ethernet-Kit Example Configuration"

  choice EXAMPLE_ETH_DHCP_MODE
    prompt "DHCP mode"
    default EXAMPLE_ETH_DHCP_CLIENT
    help
      Select whether the board acts as a DHCP client (acquires an IP from
      an upstream router) or as a DHCP server (assigns IPs to connected hosts).

    config EXAMPLE_ETH_DHCP_CLIENT
      bool "DHCP client"
      help
        The ESP32 requests an IP address from the network's DHCP server.

    config EXAMPLE_ETH_DHCP_SERVER
      bool "DHCP server"
      help
        The ESP32 acts as a DHCP server. It gets a static IP and hands out
        addresses to connected hosts. Configure the static IP below.
  endchoice

  if EXAMPLE_ETH_DHCP_SERVER

    config EXAMPLE_ETH_SERVER_IP
      string "Server static IP address"
      default "192.168.4.1"
      help
        Static IPv4 address assigned to the ESP32's Ethernet interface when
        operating as a DHCP server.

    config EXAMPLE_ETH_SERVER_NETMASK
      string "Server netmask"
      default "255.255.255.0"
      help
        Netmask for the DHCP server subnet.

    config EXAMPLE_ETH_SERVER_GW
      string "Server gateway"
      default "192.168.4.1"
      help
        Gateway address advertised to DHCP clients (usually the server's own IP).

  endif # EXAMPLE_ETH_DHCP_SERVER

endmenu
```

## components/esp32-p4-eth/Kconfig.projbuild
```kconfig
menu "ESP32-P4-ETH Configuration"

  choice ESP32_P4_ETH_DISPLAY
    prompt "MIPI-DSI display panel"
    default ESP32_P4_ETH_DISPLAY_ILI9881C
    help
      Select the MIPI-DSI panel attached to the Waveshare ESP32-P4-ETH. The BSP
      does not auto-detect the panel (runtime DSI-ID probing hangs the boot
      watchdog on some panels), so set this to the panel you have.

    config ESP32_P4_ETH_DISPLAY_ILI9881C
      bool "ILI9881C (10.1-inch, 800x1280)"
      help
        The 10.1-inch 800x1280 ILI9881C panel. Reset is handled over DSI (no
        reset GPIO). The backlight is driven by an on-board I2C controller, so
        there is no backlight GPIO.

    config ESP32_P4_ETH_DISPLAY_EK79007
      bool "EK79007 (7-inch, 1024x600)"
      help
        The 7-inch 1024x600 EK79007 panel. Reset is handled over DSI (no reset
        GPIO). The backlight is driven by an on-board I2C controller, so there is
        no backlight GPIO.
  endchoice

  config ESP32_P4_ETH_INTERRUPT_STACK_SIZE
    int "Interrupt task stack size (bytes)"
    default 8192
    help
      Size of the stack used for the GPIO interrupt handler task.

  config ESP32_P4_ETH_INTERRUPT_PRIORITY
    int "Interrupt task priority"
    default 0
    range 0 25
    help
      FreeRTOS priority of the GPIO interrupt handler task (0 = lowest). Raise it
      if interrupt callbacks must run promptly relative to other tasks.

  config ESP32_P4_ETH_INTERRUPT_CORE_ID
    int "Interrupt task core ID"
    default -1
    range -1 1
    help
      Core to pin the GPIO interrupt handler task to (-1 = not pinned to any core).

  config ESP32_P4_ETH_TOUCH_TASK_STACK_SIZE
    int "Touch polling task stack size (bytes)"
    default 8192
    help
      Size of the stack used for the GT911 touch polling task. Used only in
      polling mode (see ESP32_P4_ETH_TOUCH_INTERRUPT).

  config ESP32_P4_ETH_TOUCH_INTERRUPT
    bool "Use interrupt-driven touch instead of polling"
    default n
    help
      By default the ESP32-P4-ETH does not route the GT911 touch INT pin to the
      ESP32-P4, so touch is polled in a task. If you wire the touch INT pin to a
      free ESP32-P4 GPIO, enable this to read the GT911 from a GPIO interrupt
      instead of polling (lower CPU usage and latency). The GPIO is set below and
      can also be overridden at runtime via initialize_touch().

  config ESP32_P4_ETH_TOUCH_INTERRUPT_GPIO
    int "Touch interrupt GPIO"
    depends on ESP32_P4_ETH_TOUCH_INTERRUPT
    default 33
    help
      GPIO that the GT911 touch INT pin is wired to. Must be a free GPIO not used
      by another on-board peripheral.

endmenu
```
