## components/esp32-p4-wifi6-poe-eth/Kconfig.projbuild
```kconfig
menu "ESP32-P4-WIFI6-POE-ETH Configuration"

  config ESP32_P4_WIFI6_POE_ETH_INTERRUPT_STACK_SIZE
    int "Interrupt task stack size (bytes)"
    default 8192
    help
      Size of the stack used for the GPIO interrupt handler task (boot button).

  config ESP32_P4_WIFI6_POE_ETH_INTERRUPT_PRIORITY
    int "Interrupt task priority"
    default 0
    range 0 25
    help
      FreeRTOS priority of the GPIO interrupt handler task (0 = lowest). Raise it
      if interrupt callbacks must run promptly relative to other tasks.

  config ESP32_P4_WIFI6_POE_ETH_INTERRUPT_CORE_ID
    int "Interrupt task core ID"
    default -1
    range -1 1
    help
      Core to pin the GPIO interrupt handler task to (-1 = not pinned to any core).

endmenu
```

## components/ethernet/Kconfig
```kconfig
menu "ESPP Ethernet"

    config ESPP_ETHERNET_W5500
        bool "Enable WIZnet W5500 SPI Ethernet support"
        default n
        help
            Enable the WIZnet W5500 SPI Ethernet chip in espp::Ethernet
            (SpiConfig with SpiChip::W5500). Pulls in the espressif/w5500
            managed component.

    config ESPP_ETHERNET_DM9051
        bool "Enable Davicom DM9051 SPI Ethernet support"
        default n
        help
            Enable the Davicom DM9051 SPI Ethernet chip in espp::Ethernet.
            Requires adding the corresponding managed component (see
            idf_component.yml) to your project.

    config ESPP_ETHERNET_ENC28J60
        bool "Enable Microchip ENC28J60 SPI Ethernet support"
        default n
        help
            Enable the Microchip ENC28J60 SPI Ethernet chip in espp::Ethernet.
            Requires adding the corresponding managed component (see
            idf_component.yml) to your project.

endmenu
```
